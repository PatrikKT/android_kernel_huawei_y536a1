 / {
        huawei_fac_info {
                  compatible = "huawei,hw_fac_info";
                  fac,product_name = "HUAWEI G660-L175";
                  fac,hardware_ver = "HL1G660L75M";
		  fac,software_ver = "MSM8926_G660-L175_VA";
                  status = "ok";
        };
};
