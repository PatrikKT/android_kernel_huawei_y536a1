 / {
        huawei_fac_info {
                  compatible = "huawei,hw_fac_info";
                  fac,product_name = "HUAWEI G660-L073";
                  fac,hardware_ver = "HL1G660L73M";
		  fac,software_ver = "MSM8926_G660-L073_VA";
                  status = "ok";
        };
};
