/* reconstitute lcd driver parameters */
/* Copyright (c) 2013, The Linux Foundation. All rights reserved.
 *
 * This program is free software; you can redistribute it and/or modify
 * it under the terms of the GNU General Public License version 2 and
 * only version 2 as published by the Free Software Foundation.
 *
 * This program is distributed in the hope that it will be useful,
 * but WITHOUT ANY WARRANTY; without even the implied warranty of
 * MERCHANTABILITY or FITNESS FOR A PARTICULAR PURPOSE.  See the
 * GNU General Public License for more details.
 */


/ {
	mipi_otm1282a_720p_cmd_cmi {
		compatible = "huawei,lcd_panel_id0";
		status = "disable";
		qcom,mdss-dsi-panel-name = "mipi_otm1282a_720p_cmd_cmi";
		qcom,mdss-dsi-panel-controller = <&mdss_dsi0>;
		qcom,mdss-dsi-panel-type = "dsi_cmd_mode";
		qcom,mdss-dsi-panel-destination = "display_1";
		qcom,mdss-dsi-panel-framerate = <60>;
		qcom,mdss-dsi-virtual-channel-id = <0>;
		qcom,mdss-dsi-stream = <0>;
		qcom,mdss-dsi-panel-width = <720>;
		qcom,mdss-dsi-panel-height = <1280>;
		qcom,mdss-dsi-h-front-porch = <140>;
		qcom,mdss-dsi-h-back-porch = <164>;
		qcom,mdss-dsi-h-pulse-width = <8>;
		qcom,mdss-dsi-h-sync-skew = <0>;
		qcom,mdss-dsi-v-back-porch = <1>;
		qcom,mdss-dsi-v-front-porch = <6>;
		qcom,mdss-dsi-v-pulse-width = <1>;
		qcom,mdss-dsi-h-left-border = <0>;
		qcom,mdss-dsi-h-right-border = <0>;
		qcom,mdss-dsi-v-top-border = <0>;
		qcom,mdss-dsi-v-bottom-border = <0>;
		qcom,mdss-dsi-bpp = <24>;
		qcom,mdss-dsi-color-order = <0>;
		qcom,mdss-dsi-underflow-color = <0xff>;
		qcom,mdss-dsi-border-color = <0>;
		qcom,mdss-dsi-on-command = [29 01 00 00 00 00 04 FF 12 82 01
					29 01 00 00 00 00 02 00 80
					29 01 00 00 00 00 03 FF 12 82
					29 01 00 00 00 00 02 00 B0
					29 01 00 00 00 00 02 CA 02
					29 01 00 00 00 00 02 00 00
					29 01 00 00 00 00 02 1C 00
					29 01 00 00 00 00 02 00 A0
					29 01 00 00 00 00 03 C1 00 EE
					29 01 00 00 00 00 02 00 90
					29 01 00 00 00 00 02 A5 00
					29 01 00 00 00 00 02 00 B4
					29 01 00 00 00 00 02 C0 40
					29 01 00 00 00 00 02 00 82
					29 01 00 00 00 00 02 A5 02
					29 01 00 00 00 00 02 00 80
					29 01 00 00 00 00 0B C0 00 8B 00 0A 0A 00 8B 0A 0A 00
					29 01 00 00 00 00 02 00 A0
					29 01 00 00 00 00 0D C0 00 00 00 03 00 1E 06 00 00 00 00 00
					29 01 00 00 00 00 02 00 80
					29 01 00 00 00 00 09 C2 82 03 00 00 00 00 00 00
					29 01 00 00 00 00 02 00 90
					29 01 00 00 00 00 10 C2 87 0C 01 07 06 86 0C 01 07 06 85 0D 01 07 06
					29 01 00 00 00 00 02 00 A0
					29 01 00 00 00 00 10 C2 84 0D 01 07 06 87 0B 01 07 06 86 0B 01 07 06
					29 01 00 00 00 00 02 00 B0
					29 01 00 00 00 00 0B C2 85 0D 01 07 06 84 0D 01 07 06
					29 01 00 00 00 00 02 00 EA
					29 01 00 00 00 00 04 C2 22 02 11
					29 01 00 00 00 00 02 00 F9
					29 01 00 00 00 00 05 C2 08 00 0C 01
					29 01 00 00 00 00 02 00 D0
					29 01 00 00 00 00 0D C0 00 00 00 03 00 1E 06 00 00 00 00 00
					29 01 00 00 00 00 02 00 80 
					29 01 00 00 00 00 09 C3 82 03 00 00 00 00 00 00
					29 01 00 00 00 00 02 00 90
					29 01 00 00 00 00 10 C3 87 0C 01 07 06 86 0c 01 07 06 85 0d 01 07 06
					29 01 00 00 00 00 02 00 A0 
					29 01 00 00 00 00 10 C3 84 0D 01 07 06 87 0B 01 07 06 86 0B 01 07 06
					29 01 00 00 00 00 02 00 B0
					29 01 00 00 00 00 0B C3 85 0D 01 07 06 84 0D 01 07 06
					29 01 00 00 00 00 02 00 EA
					29 01 00 00 00 00 04 C3 22 02 11
					29 01 00 00 00 00 02 00 90
					29 01 00 00 00 00 10 CB 00 00 00 00 00 00 00 00 00 00 00 00 00 F0 F0
					29 01 00 00 00 00 02 00 A0 
					29 01 00 00 00 00 10 CB F0 00 00 00 00 C0 00 F0 00 00 00 00 00 00 00
					29 01 00 00 00 00 02 00 B0
					29 01 00 00 00 00 10 CB 00 00 00 00 00 00 00 00 50 50 C0 00 00 C0 00
					29 01 00 00 00 00 02 00 C0
					29 01 00 00 00 00 11 CB 14 04 04 04 04 04 04 04 04 04 14 04 04 14 3B 3B
					29 01 00 00 00 00 02 00 D0 
					29 01 00 00 00 00 10 CB 3B 14 04 04 30 35 04 F7 04 14 14 14 14 04 04
					29 01 00 00 00 00 02 00 E0 
					29 01 00 00 00 00 10 CB 04 04 04 04 04 04 04 04 15 15 07 14 14 00 00
					29 01 00 00 00 00 02 00 F0
					29 01 00 00 00 00 0E CB 00 00 00 00 00 C0 00 00 00 00 00 00 00
					29 01 00 00 00 00 02 00 80 
					29 01 00 00 00 00 0B CC 0F 03 04 05 06 07 08 09 0A 10
					29 01 00 00 00 00 02 00 B0
					29 01 00 00 00 00 0B CC 0F 0A 09 08 07 06 05 04 03 10
					29 01 00 00 00 00 02 00 8A 
					29 01 00 00 00 00 02 CD 0B
					29 01 00 00 00 00 02 00 A0
					29 01 00 00 00 00 10 CD 06 07 08 09 14 2D 14 2D 2D 2D 2D 2D 2D 2D 2D
					29 01 00 00 00 00 02 00 B0
					29 01 00 00 00 00 10 CD 2D 2D 2D 15 12 2C 0C 0B 13 0E 0F 10 2D 2D 2D
					29 01 00 00 00 00 02 00 C0
					29 01 00 00 00 00 0B CD 2D 2D 2D 27 28 29 2A 2B 1D 2D
					29 01 00 00 00 00 02 00 0D
					29 01 00 00 00 00 10 CD 02 03 04 05 14 2D 14 2D 2D 2D 2D 2D 2D 2D 2D
					29 01 00 00 00 00 02 00 E0
					29 01 00 00 00 00 10 CD 2D 2D 2D 15 12 2C 0C 0B 13 0E 0F 10 2D 2D 2D
					29 01 00 00 00 00 02 00 F0
					29 01 00 00 00 00 0B CD 2D 2D 2D 27 28 29 2A 2B 1D 2D
					29 01 00 00 00 00 02 00 90
					29 01 00 00 00 00 0B C5 92 D6 B5 AF B2 AA 44 22 20 88
					29 01 00 00 00 00 02 00 A0
					29 01 00 00 00 00 0B C5 92 D6 B5 AF B2 AA 44 22 20 88
					29 01 00 00 00 00 02 00 00
					29 01 00 00 00 00 03 D8 38 38
					29 01 00 00 00 00 19 E1 01 24 2D 3B 45 4C 5A 6C 78 88 93 9A 60 5B 56 4C 3C 2F 25 22 19 16 13 0F
					29 01 00 00 00 00 19 E2 01 24 2D 3B 45 4C 5A 6C 78 88 93 9A 60 5B 56 4C 3C 2F 25 22 19 16 13 0F
					29 01 00 00 00 00 19 E3 01 24 2D 3B 45 4C 5A 6C 78 88 93 9A 60 5B 56 4C 3C 2F 25 22 19 16 13 0F
					29 01 00 00 00 00 19 E4 01 24 2D 3B 45 4C 5A 6C 78 88 93 9A 60 5B 56 4C 3C 2F 25 22 19 16 13 0F
					29 01 00 00 00 00 19 E5 01 24 2D 3B 45 4C 5A 6C 78 88 93 9A 60 5B 56 4C 3C 2F 25 22 19 16 13 0F
					29 01 00 00 00 00 19 E6 01 24 2D 3B 45 4C 5A 6C 78 88 93 9A 60 5B 56 4C 3C 2F 25 22 19 16 13 0F
					29 01 00 00 00 00 02 00 00
					29 01 00 00 00 00 02 C6 10
					29 01 00 00 00 00 02 00 97
					29 01 00 00 00 00 03 C5 22 20
					29 01 00 00 00 00 02 00 A7 
					29 01 00 00 00 00 03 C5 22 20
					29 01 00 00 00 00 02 00 83
					29 01 00 00 00 00 02 C4 02
					29 01 00 00 00 00 02 00 80 
					29 01 00 00 00 00 02 A5 0C
					29 01 00 00 00 00 02 00 B3
					29 01 00 00 00 00 02 C0 33
					29 01 00 00 00 00 02 00 80
					29 01 00 00 00 00 02 C4 04
					29 01 00 00 00 00 02 00 81
					29 01 00 00 00 00 02 C4 0F
					29 01 00 00 00 00 02 00 80
					29 01 00 00 00 00 03 FF 00 00
					29 01 00 00 00 00 02 00 00
					29 01 00 00 00 00 04 FF 00 00 00
					29 01 00 00 00 00 02 55 01
					29 01 00 00 00 00 02 53 24
					29 01 00 00 00 00 02 35 00
					05 01 00 00 78 00 02 11 00
					29 01 00 00 16 00 02 29 00];
		qcom,mdss-dsi-off-command = [05 01 00 00 16 00 02 28 00
					05 01 00 00 78 00 02 10 00];
		qcom,mdss-dsi-on-command-state = "dsi_lp_mode";
		qcom,mdss-dsi-off-command-state = "dsi_hs_mode";
		qcom,mdss-dsi-h-sync-pulse = <1>;
		qcom,mdss-dsi-traffic-mode = <2>;
		qcom,mdss-dsi-lane-map = <0>;
		qcom,mdss-dsi-bllp-eof-power-mode;
		qcom,mdss-dsi-bllp-power-mode;
		qcom,mdss-dsi-lane-0-state;
		qcom,mdss-dsi-lane-1-state;
		qcom,mdss-dsi-lane-2-state;
		qcom,mdss-dsi-lane-3-state;
		qcom,mdss-dsi-te-pin-select = <1>;
		qcom,mdss-dsi-te-v-sync-rd-ptr-irq-line = <0x2c>;
		qcom,mdss-dsi-te-dcs-command = <1>;
		qcom,mdss-dsi-te-check-enable;
		qcom,mdss-dsi-te-using-te-pin;
		qcom,mdss-dsi-panel-timings = [7d 25 1d 00 37 33 22 27 1e 03 04 00];
		qcom,mdss-dsi-t-clk-post = <0x20>;
		qcom,mdss-dsi-t-clk-pre = <0x2c>;
		qcom,mdss-dsi-bl-min-level = <1>;
		qcom,mdss-dsi-bl-max-level = <255>;
		qcom,mdss-dsi-dma-trigger = <4>;
		qcom,mdss-dsi-mdp-trigger = <0>;
		qcom,mdss-dsi-bl-pmic-control-type = "bl_ctrl_dcs";

	};
};
