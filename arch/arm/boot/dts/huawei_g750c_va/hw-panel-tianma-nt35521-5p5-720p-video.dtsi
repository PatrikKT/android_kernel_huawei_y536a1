/* Copyright (c) 2013, The Linux Foundation. All rights reserved.
 *
 * This program is free software; you can redistribute it and/or modify
 * it under the terms of the GNU General Public License version 2 and
 * only version 2 as published by the Free Software Foundation.
 *
 * This program is distributed in the hope that it will be useful,
 * but WITHOUT ANY WARRANTY; without even the implied warranty of
 * MERCHANTABILITY or FITNESS FOR A PARTICULAR PURPOSE.  See the
 * GNU General Public License for more details.
 */

/*---------------------------------------------------------------------------
 * This file is autogenerated file using gcdb parser. Please do not edit it.
 * Update input XML file to add a new entry or update variable in this file
 * VERSION = "1.0"
 *---------------------------------------------------------------------------*/
&mdss_mdp {
	dsi_tianma_nt35521_5p5_720p_video: qcom,mdss_dsi_tianma_nt35521_5p5_720p_video {
		qcom,mdss-dsi-panel-name = "TIANMA_NT35521_5P5_720P_VIDEO";
		qcom,cont-splash-enabled;
		qcom,mdss-dsi-panel-controller = <&mdss_dsi0>;
		qcom,mdss-dsi-panel-type = "dsi_video_mode";
		qcom,mdss-dsi-panel-destination = "display_1";
		qcom,mdss-dsi-panel-clockrate = <391000000>;
		qcom,mdss-dsi-panel-framerate = <60>;
		qcom,mdss-dsi-virtual-channel-id = <0>;
		qcom,mdss-dsi-stream = <0>;
		qcom,mdss-dsi-panel-width = <720>;
		qcom,mdss-dsi-panel-height = <1280>;
		qcom,mdss-dsi-h-front-porch = <42>;
		qcom,mdss-dsi-h-back-porch = <47>;
		qcom,mdss-dsi-h-pulse-width = <13>;
		qcom,mdss-dsi-h-sync-skew = <0>;
		qcom,mdss-dsi-v-back-porch = <20>;
		qcom,mdss-dsi-v-front-porch = <20>;
		qcom,mdss-dsi-v-pulse-width = <1>;
		qcom,mdss-dsi-h-left-border = <0>;
		qcom,mdss-dsi-h-right-border = <0>;
		qcom,mdss-dsi-v-top-border = <0>;
		qcom,mdss-dsi-v-bottom-border = <0>;
		qcom,mdss-dsi-bpp = <24>;
		qcom,mdss-dsi-underflow-color = <0xff>;
		qcom,mdss-dsi-border-color = <0>;
		qcom,mdss-dsi-color-order = "rgb_swap_rgb";
		qcom,mdss-dsi-pixel-packing = "tight";
		qcom,mdss-dsi-on-command = [29 01 00 00 00 00 05 FF AA 55 A5 80
					29 01 00 00 00 00 03 6F 11 00
					29 01 00 00 00 00 03 F7 20 00
					29 01 00 00 00 00 02 6F 11
					29 01 00 00 00 00 02 F3 01
					29 01 00 00 00 00 06 F0 55 AA 52 08 00
					29 01 00 00 00 00 02 B1 60
					29 01 00 00 00 00 06 BD 01 A0 0C 08 01
					29 01 00 00 00 00 02 6F 02
					29 01 00 00 00 00 02 B8 01
					29 01 00 00 00 00 03 BB 11 11
					29 01 00 00 00 00 03 BC 00 00
					29 01 00 00 00 00 02 B6 06
					29 01 00 00 00 00 06 F0 55 AA 52 08 01
					29 01 00 00 00 00 03 B0 09 09
					29 01 00 00 00 00 03 B1 09 09
					29 01 00 00 00 00 03 BC 78 00
					29 01 00 00 00 00 03 BD 78 00
					29 01 00 00 00 00 02 CA 00
					29 01 00 00 00 00 02 C0 04
					29 01 00 00 00 00 03 B5 03 03
					29 01 00 00 00 00 03 B3 28 28
					29 01 00 00 00 00 03 B4 0F 0F
					29 01 00 00 00 00 03 B9 34 34
					29 01 00 00 00 00 03 BA 15 15
					29 01 00 00 00 00 06 F0 55 AA 52 08 02
					29 01 00 00 00 00 02 EE 01
					29 01 00 00 00 00 11 B0 00 00 00 95 00 BB 00 D6 00 EB 01 0D 01 28 01 54
					29 01 00 00 00 00 11 B1 01 76 01 AD 01 D8 02 1B 02 54 02 55 02 88 02 BE
					29 01 00 00 00 00 11 B2 02 E1 03 0E 03 2B 03 51 03 6A 03 89 03 9D 03 B5
					29 01 00 00 00 00 05 B3 03 E0 03 FF
					29 01 00 00 00 00 02 6F 02
					29 01 00 00 00 00 02 F7 47
					29 01 00 00 00 00 02 6F 0A
					29 01 00 00 00 00 02 F7 02
					29 01 00 00 00 00 02 6F 17
					29 01 00 00 00 00 02 F4 70
					29 01 00 00 00 00 02 6F 11
					29 01 00 00 00 00 02 F3 01
					29 01 00 00 00 00 06 F0 55 AA 52 08 06
					29 01 00 00 00 00 03 B0 12 10
					29 01 00 00 00 00 03 B1 18 16
					29 01 00 00 00 00 03 B2 00 02
					29 01 00 00 00 00 03 B3 31 31
					29 01 00 00 00 00 03 B4 31 31
					29 01 00 00 00 00 03 B5 31 31
					29 01 00 00 00 00 03 B6 31 31
					29 01 00 00 00 00 03 B7 31 31
					29 01 00 00 00 00 03 B8 31 08
					29 01 00 00 00 00 03 B9 2E 2D
					29 01 00 00 00 00 03 BA 2D 2E
					29 01 00 00 00 00 03 BB 09 31
					29 01 00 00 00 00 03 BC 31 31
					29 01 00 00 00 00 03 BD 31 31
					29 01 00 00 00 00 03 BE 31 31
					29 01 00 00 00 00 03 BF 31 31
					29 01 00 00 00 00 03 C0 31 31
					29 01 00 00 00 00 03 C1 03 01
					29 01 00 00 00 00 03 C2 17 19
					29 01 00 00 00 00 03 C3 11 13
					29 01 00 00 00 00 03 E5 31 31
					29 01 00 00 00 00 03 C4 17 19
					29 01 00 00 00 00 03 C5 11 13
					29 01 00 00 00 00 03 C6 03 01
					29 01 00 00 00 00 03 C7 31 31
					29 01 00 00 00 00 03 C8 31 31
					29 01 00 00 00 00 03 C9 31 31
					29 01 00 00 00 00 03 CA 31 31
					29 01 00 00 00 00 03 CB 31 31
					29 01 00 00 00 00 03 CC 31 09
					29 01 00 00 00 00 03 CD 2D 2E
					29 01 00 00 00 00 03 CE 2E 2D
					29 01 00 00 00 00 03 CF 08 31
					29 01 00 00 00 00 03 D0 31 31
					29 01 00 00 00 00 03 D1 31 31
					29 01 00 00 00 00 03 D2 31 31
					29 01 00 00 00 00 03 D3 31 31
					29 01 00 00 00 00 03 D4 31 31
					29 01 00 00 00 00 03 D5 00 02
					29 01 00 00 00 00 03 D6 12 10
					29 01 00 00 00 00 03 D7 18 16
					29 01 00 00 00 00 06 D8 00 00 00 00 00
					29 01 00 00 00 00 06 D9 00 00 00 00 00
					29 01 00 00 00 00 02 E7 00
					29 01 00 00 00 00 06 F0 55 AA 52 08 05
					29 01 00 00 00 00 02 ED 30
					29 01 00 00 00 00 06 F0 55 AA 52 08 03
					29 01 00 00 00 00 03 B1 20 00
					29 01 00 00 00 00 03 B0 20 00
					29 01 00 00 00 00 06 F0 55 AA 52 08 05
					29 01 00 00 00 00 02 E5 00
					29 01 00 00 00 00 06 F0 55 AA 52 08 05
					29 01 00 00 00 00 03 B0 17 06
					29 01 00 00 00 00 02 B8 00
					29 01 00 00 00 00 06 BD 03 03 01 00 03
					29 01 00 00 00 00 03 B1 17 06
					29 01 00 00 00 00 03 B9 00 03
					29 01 00 00 00 00 03 B2 17 06
					29 01 00 00 00 00 03 BA 00 00
					29 01 00 00 00 00 03 B3 17 06
					29 01 00 00 00 00 03 BB 00 00
					29 01 00 00 00 00 03 B4 17 06
					29 01 00 00 00 00 03 B5 17 06
					29 01 00 00 00 00 03 B6 17 06
					29 01 00 00 00 00 03 B7 17 06
					29 01 00 00 00 00 03 BC 00 03
					29 01 00 00 00 00 02 E5 06
					29 01 00 00 00 00 02 E6 06
					29 01 00 00 00 00 02 E7 06
					29 01 00 00 00 00 02 E8 06
					29 01 00 00 00 00 02 E9 06
					29 01 00 00 00 00 02 EA 06
					29 01 00 00 00 00 02 EB 06
					29 01 00 00 00 00 02 EC 06
					29 01 00 00 00 00 06 F0 55 AA 52 08 05
					29 01 00 00 00 00 02 C0 0B
					29 01 00 00 00 00 02 C1 09
					29 01 00 00 00 00 02 C2 0B
					29 01 00 00 00 00 02 C3 09
					29 01 00 00 00 00 06 F0 55 AA 52 08 03
					29 01 00 00 00 00 06 B2 05 00 00 00 90
					29 01 00 00 00 00 06 B3 05 00 00 00 90
					29 01 00 00 00 00 06 B4 05 00 00 00 90
					29 01 00 00 00 00 06 B5 05 00 00 00 90
					29 01 00 00 00 00 06 F0 55 AA 52 08 05
					29 01 00 00 00 00 02 C4 10
					29 01 00 00 00 00 02 C5 10
					29 01 00 00 00 00 02 C6 10
					29 01 00 00 00 00 02 C7 10
					29 01 00 00 00 00 06 F0 55 AA 52 08 03
					29 01 00 00 00 00 06 B6 05 00 00 00 90
					29 01 00 00 00 00 06 B7 05 00 00 00 90
					29 01 00 00 00 00 06 B8 05 00 00 00 90
					29 01 00 00 00 00 06 B9 05 00 00 00 90
					29 01 00 00 00 00 06 F0 55 AA 52 08 05
					29 01 00 00 00 00 03 C8 08 20
					29 01 00 00 00 00 03 C9 04 20
					29 01 00 00 00 00 03 CA 07 00
					29 01 00 00 00 00 03 CB 03 00
					29 01 00 00 00 00 06 F0 55 AA 52 08 03
					29 01 00 00 00 00 06 BA 53 01 00 01 00
					29 01 00 00 00 00 06 BB 53 01 00 01 00
					29 01 00 00 00 00 06 BC 53 01 00 01 00
					29 01 00 00 00 00 06 BD 53 01 00 01 00
					29 01 00 00 00 00 06 F0 55 AA 52 08 05
					29 01 00 00 00 00 06 D1 00 05 00 07 10
					29 01 00 00 00 00 06 D2 00 05 04 07 10
					29 01 00 00 00 00 06 D3 00 00 0A 07 10
					29 01 00 00 00 00 06 D4 00 00 0A 07 10
					29 01 00 00 00 00 06 F0 55 AA 52 08 05
					29 01 00 00 00 00 08 D0 00 00 00 00 00 00 00
					29 01 00 00 00 00 0c D5 00 00 00 00 00 00 00 00 00 00 00
					29 01 00 00 00 00 0c D6 00 00 00 00 00 00 00 00 00 00 00
					29 01 00 00 00 00 0c D7 00 00 00 00 00 00 00 00 00 00 00
					29 01 00 00 00 00 06 D8 00 00 00 00 00
					29 01 00 00 00 00 06 F0 55 AA 52 08 03
					29 01 00 00 00 00 02 C4 60
					29 01 00 00 00 00 02 C5 40
					29 01 00 00 00 00 02 C6 60
					29 01 00 00 00 00 02 C7 40
					29 01 00 00 00 00 02 6F 01
					29 01 00 00 00 00 02 F9 46
					29 01 00 00 00 00 02 6F 12
					29 01 00 00 00 00 02 F3 80
					29 01 00 00 00 00 02 6F 0C
					29 01 00 00 00 00 05 F3 FF 0F FF FF
					29 01 00 00 00 00 02 6F 12
					29 01 00 00 00 00 02 F3 00
					29 01 00 00 00 00 06 F0 55 AA 52 08 01
					29 01 00 00 00 00 03 BC 78 00
					29 01 00 00 00 00 03 BD 78 00
					29 01 00 00 00 00 06 F0 55 AA 52 08 02
					29 01 00 00 00 00 02 EE 01
					29 01 00 00 00 00 11 B0 00 00 00 95 00 BB 00 D6 00 EB 01 0D 01 28 01 54
					29 01 00 00 00 00 11 B1 01 76 01 AD 01 D8 02 1B 02 54 02 55 02 88 02 BE
					29 01 00 00 00 00 11 B2 02 E1 03 0E 03 2B 03 51 03 6A 03 89 03 9D 03 B5
					29 01 00 00 00 00 05 B3 03 E0 03 FF
					29 01 00 00 00 00 06 F0 55 AA 52 08 00
					29 01 00 00 00 00 03 D9 02 05
					29 01 00 00 00 00 02 55 01
					29 01 00 00 00 00 02 53 24
					29 01 00 00 00 00 02 51 00
					05 01 00 00 78 00 02 11 00
					05 01 00 00 14 00 02 29 00];
		qcom,mdss-dsi-off-command = [05 01 00 00 14 00 02 28 00
					05 01 00 00 78 00 02 10 00];
		qcom,mdss-dsi-on-command-state = "dsi_lp_mode";
		qcom,mdss-dsi-off-command-state = "dsi_hs_mode";
		qcom,mdss-dsi-h-sync-pulse = <1>;
		qcom,mdss-dsi-traffic-mode = "burst_mode";
		qcom,mdss-dsi-lane-map = "lane_map_0123";
		qcom,mdss-dsi-bllp-eof-power-mode;
		qcom,mdss-dsi-bllp-power-mode;
		qcom,mdss-dsi-lane-0-state;
		qcom,mdss-dsi-lane-1-state;
		qcom,mdss-dsi-lane-2-state;
		qcom,mdss-dsi-lane-3-state;
		qcom,mdss-dsi-panel-timings = [76 18 10 00 3a 3e 14 1c 12 03 04 00];
		qcom,mdss-dsi-reset-sequence = <1 1>, <0 20>, <1 120>;
		qcom,mdss-dsi-t-clk-post = <0x20>;
		qcom,mdss-dsi-t-clk-pre = <0x2D>;
		qcom,mdss-dsi-bl-min-level = <1>;
		qcom,mdss-dsi-bl-max-level = <255>;
		qcom,mdss-dsi-dma-trigger = "trigger_sw";
		qcom,mdss-dsi-mdp-trigger = "none";
		qcom,mdss-dsi-bl-pmic-control-type = "bl_ctrl_dcs";
		qcom,panel-cabc-ui-cmds = [15 01 00 00 00 00 02 55 01
					15 01 00 00 00 00 02 53 24];
		qcom,panel-cabc-video-cmds = [15 01 00 00 00 00 02 55 03
					15 01 00 00 00 00 02 53 2C];
		qcom,cabc-ui-cmds-dsi-state = "dsi_hs_mode";
		qcom,cabc-video-cmds-dsi-state = "dsi_hs_mode";
		qcom,mdss-dsi-lp11-init;
		huawei,mdss-dsi-pan-enable-dynamic-fps;
		huawei,mdss-dsi-panel-timings-30-fps = [76 18 10 00 3a 3e 08 1c 04 03 04 00];
	};
};
