&pm8226_bms {
	status = "okay";
	qcom,batt-type = <4>;
	qcom,max-voltage-uv = <4350000>;
};

&pm8226_chg {
	status = "okay";
	qcom,vddmax-mv = <4350>;
	qcom,vddsafe-mv = <4380>;
	qcom,tchg-mins = <240>;
};
&pm8226_vadc {
	pa_mpp_number = <20>;
	cpu_mpp_number = <20>;
};
