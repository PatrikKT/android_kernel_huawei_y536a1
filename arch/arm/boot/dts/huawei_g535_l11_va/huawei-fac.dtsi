 / {
        huawei_fac_info {
                  compatible = "huawei,hw_fac_info";
                  fac,product_name = "HUAWEI G535-L11";
                  fac,hardware_ver = "HL1G535M";
		  fac,software_ver = "MSM8926_G535-L11_VA";
                  status = "ok";
        };
};
