/ {
    huawei_audio_info {
        compatible = "huawei,hw_audio_info";
        builtin-mic-type = "dual";
        product-identifier = "g6l11";
        codec-type = "wcd9302";
        builtin-master-mic-exist;
        builtin-2nd-mic-exist;
        hand_held_dual_mic_strategy;
        status = "ok";
        aud_param_ver = "default";
        product-btsco-nrec-adapt;
        loud_speaker_master_mic_strategy;
    };
};
&soc {
    sound-9302 {
        huawei,audio-routing =
            "RX_BIAS", "MCLK",
            "LDO_H", "MCLK",
            "SPK_OUT", "MCLK",
            "AMIC1", "MIC BIAS1 External",
            "MIC BIAS1 External", "Handset Mic",
            "AMIC2", "MIC BIAS2 External",
            "MIC BIAS2 External", "Headset Mic",
            "AMIC3", "MIC BIAS1 External",
            "MIC BIAS1 External", "Analog Mic3",
            "AMIC4", "MIC BIAS1 External",
            "MIC BIAS1 External", "Analog Mic4";

        huawei,cdc-mclk-gpios = <&pm8226_gpios 1 0>;
        huawei,cdc-vdd-spkr-gpios = <&msmgpio 111 0>;
        huawei,headset-jack-type-NO;
    };
};
