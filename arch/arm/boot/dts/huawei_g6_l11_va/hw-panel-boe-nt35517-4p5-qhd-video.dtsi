/* Copyright (c) 2013, The Linux Foundation. All rights reserved.
 *
 * This program is free software; you can redistribute it and/or modify
 * it under the terms of the GNU General Public License version 2 and
 * only version 2 as published by the Free Software Foundation.
 *
 * This program is distributed in the hope that it will be useful,
 * but WITHOUT ANY WARRANTY; without even the implied warranty of
 * MERCHANTABILITY or FITNESS FOR A PARTICULAR PURPOSE.  See the
 * GNU General Public License for more details.
 */

/*---------------------------------------------------------------------------
 * This file is autogenerated file using gcdb parser. Please do not edit it.
 * Update input XML file to add a new entry or update variable in this file
 * VERSION = "1.0"
 *---------------------------------------------------------------------------*/
&mdss_mdp {
	dsi_boe_nt35517_4p5_qhd_video: qcom,mdss_dsi_boe_nt35517_4p5_qhd_video {
		qcom,mdss-dsi-panel-name = "BOE_NT35517_4P5_QHD_VIDEO";
		qcom,cont-splash-enabled;
		qcom,mdss-dsi-panel-controller = <&mdss_dsi0>;
		qcom,mdss-dsi-panel-type = "dsi_video_mode";
		qcom,mdss-dsi-panel-destination = "display_1";
		qcom,mdss-dsi-panel-clockrate = <443000000>;
		qcom,mdss-dsi-panel-framerate = <60>;
		qcom,mdss-dsi-virtual-channel-id = <0>;
		qcom,mdss-dsi-stream = <0>;
		qcom,mdss-dsi-panel-width = <540>;
		qcom,mdss-dsi-panel-height = <960>;
		qcom,mdss-dsi-h-front-porch = <38>;
		qcom,mdss-dsi-h-back-porch = <38>;
		qcom,mdss-dsi-h-pulse-width = <4>;
		qcom,mdss-dsi-h-sync-skew = <0>;
		qcom,mdss-dsi-v-back-porch = <16>;
		qcom,mdss-dsi-v-front-porch = <16>;
		qcom,mdss-dsi-v-pulse-width = <1>;
		qcom,mdss-dsi-h-left-border = <0>;
		qcom,mdss-dsi-h-right-border = <0>;
		qcom,mdss-dsi-v-top-border = <0>;
		qcom,mdss-dsi-v-bottom-border = <0>;
		qcom,mdss-dsi-bpp = <24>;
		qcom,mdss-dsi-underflow-color = <0xff>;
		qcom,mdss-dsi-border-color = <0>;
		qcom,mdss-dsi-color-order = "rgb_swap_rgb";
		qcom,mdss-dsi-pixel-packing = "tight";
		qcom,mdss-dsi-on-command = [39 01 00 00 00 00 06 F0 55 AA 52 08 00
						39 01 00 00 00 00 02 BC 00
						39 01 00 00 00 00 04 CC 03 00 00
						39 01 00 00 00 00 06 B0 00 0C 40 3C 3C
						39 01 00 00 00 00 03 B1 F4 00
						39 01 00 00 00 00 02 B6 09
						39 01 00 00 00 00 03 B7 03 02
						39 01 00 00 00 00 05 B8 01 02 02 02
						39 01 00 00 00 00 02 BA 01
						39 01 00 00 00 00 04 BB 99 03 73
						39 01 00 00 00 00 06 BD 01 54 06 10 01
						39 01 00 00 00 00 03 E0 00 01
						39 01 00 00 00 00 0B E3 E5 E3 E1 E0 DC D7 D0 CC C8 C4
						39 01 00 00 00 00 06 F0 55 AA 52 08 01
						39 01 00 00 00 00 04 B0 0A 0A 0A
						39 01 00 00 00 00 04 B6 33 33 33
						39 01 00 00 00 00 04 B1 0A 0A 0A
						39 01 00 00 00 00 04 B7 24 24 24
						39 01 00 00 00 00 04 B2 03 03 03
						39 01 00 00 00 00 04 B8 33 33 33
						39 01 00 00 00 00 04 B3 0C 0C 0C
						39 01 00 00 00 00 04 B9 25 25 25
						39 01 00 00 00 00 04 B4 0A 0A 0A
						39 01 00 00 00 00 04 BA 25 25 25
						39 01 00 00 00 00 04 B5 07 07 07
						39 01 00 00 00 00 04 BC 00 90 06
						39 01 00 00 00 00 04 BD 00 90 06
						39 01 00 00 00 00 11 D1 00 43 00 51 00 6C 00 83 00 95 00 B5 00 D2 01 03
						39 01 00 00 00 00 11 D2 01 2C 01 6E 01 A4 01 FB 02 44 02 46 02 87 02 CC
						39 01 00 00 00 00 11 D3 02 F3 03 29 03 4D 03 78 03 96 03 BA 03 DE 03 F4
						39 01 00 00 00 00 05 D4 03 FE 03 FF
						39 01 00 00 00 00 11 D5 00 43 00 51 00 6C 00 83 00 95 00 B5 00 D2 01 03
						39 01 00 00 00 00 11 D6 01 2C 01 6E 01 A4 01 FB 02 44 02 46 02 87 02 CC
						39 01 00 00 00 00 11 D7 02 F3 03 29 03 4D 03 78 03 96 03 BA 03 DE 03 F4
						39 01 00 00 00 00 05 D8 03 FE 03 FF
						39 01 00 00 00 00 11 D9 00 43 00 51 00 6C 00 83 00 95 00 B5 00 D2 01 03
						39 01 00 00 00 00 11 DD 01 2C 01 6E 01 A4 01 FB 02 44 02 46 02 87 02 CC
						39 01 00 00 00 00 11 DE 02 F3 03 29 03 4D 03 78 03 96 03 BA 03 DE 03 F4
						39 01 00 00 00 00 05 DF 03 FE 03 FF
						39 01 00 00 00 00 11 E0 00 43 00 51 00 6C 00 83 00 95 00 B5 00 D2 01 03
						39 01 00 00 00 00 11 E1 01 2C 01 6E 01 A4 01 FB 02 44 02 46 02 87 02 CC
						39 01 00 00 00 00 11 E2 02 F3 03 29 03 4D 03 78 03 96 03 BA 03 DE 03 F4
						39 01 00 00 00 00 05 E3 03 FE 03 FF
						39 01 00 00 00 00 11 E4 00 43 00 51 00 6C 00 83 00 95 00 B5 00 D2 01 03
						39 01 00 00 00 00 11 E5 01 2C 01 6E 01 A4 01 FB 02 44 02 46 02 87 02 CC
						39 01 00 00 00 00 11 E6 02 F3 03 29 03 4D 03 78 03 96 03 BA 03 DE 03 F4
						39 01 00 00 00 00 05 E7 03 FE 03 FF
						39 01 00 00 00 00 11 E8 00 43 00 51 00 6C 00 83 00 95 00 B5 00 D2 01 03
						39 01 00 00 00 00 11 E9 01 2C 01 6E 01 A4 01 FB 02 44 02 46 02 87 02 CC
						39 01 00 00 00 00 11 EA 02 F3 03 29 03 4D 03 78 03 96 03 BA 03 DE 03 F4
						39 01 00 00 00 00 05 EB 03 FE 03 FF
						15 01 00 00 00 00 02 51 00
						15 01 00 00 00 00 02 53 24
						15 01 00 00 00 00 02 55 02
						15 01 00 00 00 00 02 5E 28
						05 01 00 00 78 00 02 11 00
						05 01 00 00 14 00 02 29 00];
		qcom,mdss-dsi-off-command = [05 01 00 00 14 00 02 28 00
					05 01 00 00 78 00 02 10 00];
		qcom,mdss-dsi-on-command-state = "dsi_lp_mode";
		qcom,mdss-dsi-off-command-state = "dsi_hs_mode";
		qcom,mdss-dsi-h-sync-pulse = <1>;
		qcom,mdss-dsi-traffic-mode = "burst_mode";
		qcom,mdss-dsi-lane-map = "lane_map_3012";
		qcom,mdss-dsi-bllp-eof-power-mode;
		qcom,mdss-dsi-bllp-power-mode;
		qcom,mdss-dsi-lane-0-state;
		qcom,mdss-dsi-lane-1-state;
		qcom,mdss-dsi-panel-timings = [7a 1a 12 00 3e 42 16 1e 14 03 04 00];
		qcom,mdss-dsi-reset-sequence = <1 1>, <0 20>, <1 120>;
		qcom,mdss-dsi-t-clk-post = <0x04>;
		qcom,mdss-dsi-t-clk-pre = <0x1d>;
		qcom,mdss-dsi-bl-min-level = <10>;
		qcom,mdss-dsi-bl-max-level = <255>;
		qcom,mdss-dsi-dma-trigger = "trigger_sw";
		qcom,mdss-dsi-mdp-trigger = "none";
		qcom,mdss-dsi-bl-pmic-control-type = "bl_ctrl_dcs";
		qcom,panel-inverse-off-cmds = [05 01 00 00 00 00 02 20 00];
		qcom,panel-inverse-on-cmds = [05 01 00 00 00 00 02 21 00];
		qcom,inverse-on-cmds-dsi-state = "dsi_lp_mode";
		qcom,inverse-off-cmds-dsi-state = "dsi_lp_mode";
		qcom,panel-SetTemporary-pwm-cmds = [29 01 00 00 00 00 06 F0 55 AA 52 08 00
	                            29 01 00 00 00 00 03 E0 00 02];
		qcom,panel-SetNormal-pwm-cmds = [29 01 00 00 00 00 06 F0 55 AA 52 08 00
	                          29 01 00 00 00 00 03 E0 00 01];
		qcom,temporary-pwm-command-dsi-state = "dsi_lp_mode";
		qcom,normal-pwm-command-dsi-state = "dsi_lp_mode";
		qcom,panel-cabc-ui-cmds = [29 01 00 00 00 00 06 F0 55 AA 52 08 00
					29 01 00 00 00 00 0B E3 E5 E3 E1 E0 DC D7 D0 CC C8 C4
					15 01 00 00 00 00 02 53 24];
		qcom,panel-cabc-video-cmds = [29 01 00 00 00 00 06 F0 55 AA 52 08 00
					29 01 00 00 00 00 0B E3 F0 D2 C3 B4 A5 96 87 87 87 81
					15 01 00 00 00 00 02 53 2C];
		qcom,cabc-ui-cmds-dsi-state = "dsi_hs_mode";
		qcom,cabc-video-cmds-dsi-state = "dsi_hs_mode";
		qcom,panel-dot-inversion-mode-cmds = [29 01 00 00 00 00 06 F0 55 AA 52 08 00
				29 01 00 00 00 00 02 BC 01];
		qcom,panel-column-inversion-mode-cmds = [29 01 00 00 00 00 06 F0 55 AA 52 08 00
				29 01 00 00 00 00 02 BC 00];
		qcom,dot-inversion-cmds-dsi-state = "dsi_lp_mode";
		qcom,column-inversion-cmds-dsi-state = "dsi_lp_mode";
		qcom,mdss-dsi-lp11-init;
	};
};
