 / {
        huawei_fac_info {
                  compatible = "huawei,hw_fac_info";
                  fac,product_name = "mainboard_A1_va";
                  fac,hardware_ver = "xxxxxxx";
		  fac,software_ver = "MSM8926_mainborad_VA";
                  status = "ok";
        };
};
