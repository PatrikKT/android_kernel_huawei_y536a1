 / {
        huawei_wifi_info {
                  compatible = "huawei,hw_wifi_info";
                  status = "ok";
                  wifi,chiptype = "WIFI_QUALCOMM_WCN3680";
                  wifi,pubfile_id = "mate2";
                  wifi,fw_ver = "1.4.1.2";
        };
};
