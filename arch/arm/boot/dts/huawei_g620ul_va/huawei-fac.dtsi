 / {
        huawei_fac_info {
                  compatible = "huawei,hw_fac_info";
                  fac,product_name = "HUAWEI G620-L72";
                  fac,hardware_ver = "HL1G620L75M_VerA";
		  fac,software_ver = "MSM8926_G620-L72_VA";
                  status = "ok";
        };
};
