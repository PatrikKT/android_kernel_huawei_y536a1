/* Copyright (c) 2013, The Linux Foundation. All rights reserved.
 *
 * This program is free software; you can redistribute it and/or modify
 * it under the terms of the GNU General Public License version 2 and
 * only version 2 as published by the Free Software Foundation.
 *
 * This program is distributed in the hope that it will be useful,
 * but WITHOUT ANY WARRANTY; without even the implied warranty of
 * MERCHANTABILITY or FITNESS FOR A PARTICULAR PURPOSE.  See the
 * GNU General Public License for more details.
 */
/dts-v1/;
/include/ "msm8226-v1.dtsi"
/include/ "msm8226-cdp.dtsi"
/include/ "huawei_g750c_va/huawei-va.dtsi"

/ {
	model = "Qualcomm MSM 8226 g750c";
	compatible = "qcom,msm8226-cdp", "qcom,msm8226", "qcom,cdp";
	qcom,msm-id = <145 8069 0>,
		      <158 8069 0>,
		      <159 8069 0>,
		      <198 8069 0>,
		      <205 8069 0>;
};
