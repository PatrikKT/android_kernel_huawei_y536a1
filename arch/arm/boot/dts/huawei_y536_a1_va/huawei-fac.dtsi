 / {
        huawei_fac_info {
                  compatible = "huawei,hw_fac_info";
                  fac,product_name = "HUAWEI Y536A1";
                  fac,hardware_ver = "HL1Y536A1M";
                  fac,software_ver = "MSM8926_Y536A1_VA";
                  status = "ok";
        };
};
