/*---------------------------------------------------------------------------
 * This file is autogenerated file using huawei LCD parser. Please do not edit it.
 * Update input XML file to add a new entry or update variable in this file
 * Parser location: device/qcom/common/display/tools/huawei_lcd_panel 
 *---------------------------------------------------------------------------*/



/include/ "hw-panel-auo-nt35517-5p5-qhd-video.dtsi"
/include/ "hw-panel-boe-nt35517-5p5-qhd-video.dtsi"
/include/ "hw-panel-tianma-hx8389b-5p5-qhd-video.dtsi"
/include/ "default_lcd.dtsi"

