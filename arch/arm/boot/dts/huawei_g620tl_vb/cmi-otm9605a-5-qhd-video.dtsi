/* Copyright (c) 2013, The Linux Foundation. All rights reserved.
 *
 * This program is free software; you can redistribute it and/or modify
 * it under the terms of the GNU General Public License version 2 and
 * only version 2 as published by the Free Software Foundation.
 *
 * This program is distributed in the hope that it will be useful,
 * but WITHOUT ANY WARRANTY; without even the implied warranty of
 * MERCHANTABILITY or FITNESS FOR A PARTICULAR PURPOSE.  See the
 * GNU General Public License for more details.
 */

/*---------------------------------------------------------------------------
 * This file is autogenerated file using gcdb parser. Please do not edit it.
 * Update input XML file to add a new entry or update variable in this file
 * VERSION = "1.0"
 *---------------------------------------------------------------------------*/
&mdss_mdp {
	dsi_cmi_otm9605a_5_qhd_video: qcom,mdss_dsi_cmi_otm9605a_5_qhd_video {
		qcom,mdss-dsi-panel-name = "CMI_OTM9605A_5_QHD_VIDEO";
		qcom,cont-splash-enabled;
		qcom,mdss-dsi-panel-controller = <&mdss_dsi0>;
		qcom,mdss-dsi-panel-type = "dsi_video_mode";
		qcom,mdss-dsi-panel-destination = "display_1";
		qcom,mdss-dsi-panel-clockrate = <0>;
		qcom,mdss-dsi-panel-framerate = <60>;
		qcom,mdss-dsi-virtual-channel-id = <0>;
		qcom,mdss-dsi-stream = <0>;
		qcom,mdss-dsi-panel-width = <540>;
		qcom,mdss-dsi-panel-height = <960>;
		qcom,mdss-dsi-h-front-porch = <100>;
		qcom,mdss-dsi-h-back-porch = <100>;
		qcom,mdss-dsi-h-pulse-width = <4>;
		qcom,mdss-dsi-h-sync-skew = <0>;
		qcom,mdss-dsi-v-back-porch = <32>;
		qcom,mdss-dsi-v-front-porch = <32>;
		qcom,mdss-dsi-v-pulse-width = <2>;
		qcom,mdss-dsi-h-left-border = <0>;
		qcom,mdss-dsi-h-right-border = <0>;
		qcom,mdss-dsi-v-top-border = <0>;
		qcom,mdss-dsi-v-bottom-border = <0>;
		qcom,mdss-dsi-bpp = <24>;
		qcom,mdss-dsi-color-order = <0>;
		qcom,mdss-dsi-underflow-color = <0xff>;
		qcom,mdss-dsi-border-color = <0>;
		qcom,mdss-dsi-pixel-packing = <0>;
		qcom,mdss-dsi-on-command = [39 01 00 00 00 00 02 00 00
39 01 00 00 00 00 04 FF 96 05 01
39 01 00 00 00 00 02 00 80
39 01 00 00 00 00 03 FF 96 05
39 01 00 00 00 00 02 00 92
39 01 00 00 00 00 03 FF 10 02
39 01 00 00 00 00 02 00 00
39 01 00 00 00 00 02 A0 00
39 01 00 00 00 00 02 00 C5
39 01 00 00 00 00 02 B0 03
39 01 00 00 00 00 02 00 A1
39 01 00 00 00 00 02 B3 10
39 01 00 00 00 00 02 00 A7
39 01 00 00 00 00 02 B3 10
39 01 00 00 00 00 02 00 D2
39 01 00 00 00 00 02 B0 04
39 01 00 00 00 00 02 00 89
39 01 00 00 00 00 02 C0 01
39 01 00 00 00 00 02 00 90
39 01 00 00 00 00 07 C0 00 44 00 00 00 03
39 01 00 00 00 00 02 00 B4
39 01 00 00 00 00 02 C0 50
39 01 00 00 00 00 02 00 80
39 01 00 00 00 00 03 C1 36 66
39 01 00 00 00 00 02 00 A0
39 01 00 00 00 00 02 C1 00
39 01 00 00 00 00 02 00 A6
39 01 00 00 00 00 04 C1 00 00 00
39 01 00 00 00 00 02 00 80
39 01 00 00 00 00 02 C4 9C
39 01 00 00 00 00 02 00 80
39 01 00 00 00 00 02 C4 40
39 01 00 00 00 00 02 00 80
39 01 00 00 00 00 1D CA 80 61 6A 71 7A 81 8A 91 9A A2 AA B2 BB C2 C2 C2 C3 FF C3 FF C3 FF 05 03 05 03 05 03
39 01 00 00 00 00 02 00 91
39 01 00 00 00 00 02 C5 76
39 01 00 00 00 00 02 00 93 
39 01 00 00 00 00 02 C5 76
39 01 00 00 00 00 02 00 B1
39 01 00 00 00 00 02 C5 28
39 01 00 00 00 00 02 00 C0
39 01 00 00 00 00 02 C5 00
39 01 00 00 00 00 02 00 B2
39 01 00 00 00 00 05 F5 15 00 15 00
39 01 00 00 00 00 02 00 80
39 01 00 00 00 00 07 CE 8B 03 00 8A 03 00
39 01 00 00 00 00 02 00 90
39 01 00 00 00 00 0F CE 23 C2 00 23 c3 00 33 C5 00 33 C6 00 00 00
39 01 00 00 00 00 02 00 A0
39 01 00 00 00 00 0F CE 38 09 03 C2 00 00 00 38 08 03 C3 00 00 00
39 01 00 00 00 00 02 00 B0
39 01 00 00 00 00 0F CE 38 07 03 c4 00 00 00 38 06 03 C5 00 00 00
39 01 00 00 00 00 02 00 C0
39 01 00 00 00 00 0F CE 38 05 03 BE 00 00 00 38 04 03 BF 00 00 00
39 01 00 00 00 00 02 00 D0
39 01 00 00 00 00 0F CE 38 03 03 c0 00 00 00 38 02 03 C1 00 00 00
39 01 00 00 00 00 02 00 C0
39 01 00 00 00 00 10 CB 00 00 04 04 04 04 04 04 04 04 00 00 04 00 00
39 01 00 00 00 00 02 00 D0
39 01 00 00 00 00 10 CB 00 00 00 00 00 00 00 04 04 04 04 04 04 04 04
39 01 00 00 00 00 02 00 E0
39 01 00 00 00 00 0B CB 00 00 04 00 00 00 00 00 00 00
39 01 00 00 00 00 02 00 80
39 01 00 00 00 00 0B CC 00 00 02 0A 0C 0E 10 21 22 06
39 01 00 00 00 00 02 00 90
39 01 00 00 00 00 10 CC 00 00 08 00 00 00 00 00 00 00 00 00 01 09 0B
39 01 00 00 00 00 02 00 A0
39 01 00 00 00 00 10 CC 0D 0F 21 22 05 00 00 07 00 00 00 00 00 00 00
39 01 00 00 00 00 02 00 B0
39 01 00 00 00 00 0B CC 00 00 05 0B 09 0F 0D 21 22 01 
39 01 00 00 00 00 02 00 C0
39 01 00 00 00 00 10 CC 00 00 07 00 00 00 00 00 00 00 00 00 06 0C 0A
39 01 00 00 00 00 02 00 D0
39 01 00 00 00 00 10 CC 10 0E 21 22 02 00 00 08 00 00 00 00 00 00 00
39 01 00 00 00 00 02 00 C0
39 01 00 00 00 00 0B CF 3D 3D 00 00 00 00 01 00 00 00
39 01 00 00 00 00 02 00 00
39 01 00 00 00 00 03 D8 6F 6F
39 01 00 00 00 00 02 00 00
39 01 00 00 00 00 11 E1 02 09 0E 0D 06 0E 0B 0A 03 07 0F 09 10 14 0E 08
39 01 00 00 00 00 02 00 00
39 01 00 00 00 00 11 E2 02 09 0E 0D 06 0F 0B 0A 03 07 0F 09 10 14 0E 08
39 01 00 00 00 00 02 00 B1
39 01 00 00 00 00 02 C6 05
39 01 00 00 00 00 04 FF FF FF FF
39 01 00 00 00 00 02 51 00
39 01 00 00 00 00 02 53 24
39 01 00 00 00 00 02 55 01
05 01 00 00 78 00 02 11 00
05 01 00 00 14 00 02 29 00];
		qcom,mdss-dsi-off-command = [05 01 00 00 14 00 02 28 00
					05 01 00 00 78 00 02 10 00];
		qcom,mdss-dsi-on-command-state = "dsi_lp_mode";
		qcom,mdss-dsi-off-command-state = "dsi_lp_mode";
		qcom,mdss-dsi-h-sync-pulse = <1>;
		qcom,mdss-dsi-traffic-mode = <2>;
		qcom,mdss-dsi-lane-map = <1>;
		qcom,mdss-dsi-bllp-eof-power-mode;
		qcom,mdss-dsi-bllp-power-mode;
		qcom,mdss-dsi-lane-0-state;
		qcom,mdss-dsi-lane-1-state;
		qcom,mdss-dsi-panel-timings = [96 22 17 00 4a 54 1b 26 27 03 04 00];
		qcom,mdss-dsi-reset-sequence = <1 1>, <0 20>, <1 120>;
		qcom,mdss-dsi-t-clk-post = <0x04>;
		qcom,mdss-dsi-t-clk-pre = <0x1b>;
		qcom,mdss-dsi-bl-min-level = <1>;
		qcom,mdss-dsi-bl-max-level = <255>;
		qcom,mdss-dsi-dma-trigger = <4>;
		qcom,mdss-dsi-mdp-trigger = <0>;
		qcom,mdss-dsi-bl-pmic-control-type = "bl_ctrl_dcs";
		qcom,panel-inverse-off-cmds = [05 01 00 00 00 00 02 20 00];
		qcom,panel-inverse-on-cmds = [05 01 00 00 00 00 02 21 00];
		qcom,inverse-on-cmds-dsi-state = "dsi_lp_mode";
		qcom,inverse-off-cmds-dsi-state = "dsi_lp_mode";
		qcom,panel-cabc-ui-cmds = [15 01 00 00 00 00 02 55 01
					15 01 00 00 00 00 02 53 24];
		qcom,panel-cabc-video-cmds = [15 01 00 00 00 00 02 55 03
					15 01 00 00 00 00 02 53 2C];
		qcom,cabc-ui-cmds-dsi-state = "dsi_hs_mode";
		qcom,cabc-video-cmds-dsi-state = "dsi_hs_mode";
	};
};
