/* Copyright (c) 2013, The Linux Foundation. All rights reserved.
 *
 * This program is free software; you can redistribute it and/or modify
 * it under the terms of the GNU General Public License version 2 and
 * only version 2 as published by the Free Software Foundation.
 *
 * This program is distributed in the hope that it will be useful,
 * but WITHOUT ANY WARRANTY; without even the implied warranty of
 * MERCHANTABILITY or FITNESS FOR A PARTICULAR PURPOSE.  See the
 * GNU General Public License for more details.
 */

qcom,qrd-4v35-2300mAh-lishen-data {
	qcom,fcc-mah = <2300>;
	qcom,default-rbatt-mohm = <146>;
	qcom,rbatt-capacitive-mohm = <0>;
	qcom,flat-ocv-threshold-uv = <3800000>;
	qcom,max-voltage-uv = <4350000>;
	qcom,v-cutoff-uv = <3400000>;
	qcom,chg-term-ua = <100000>;
	qcom,batt-id-kohm = <39>;
	qcom,batt-name = "HB444199EBC_LS_LS";

	qcom,warm-bat-decidegc = <420>;
	qcom,warm-bat-mv = <4250>;
	qcom,ibatmax-warm-ma = <800>;

	qcom,cool-bat-decidegc = <100>;
	qcom,cool-bat-mv = <4350>;
	qcom,ibatmax-cool-ma = <600>;

	qcom,hot-bat-decidegc = <520>;
	qcom,cold-bat-decidegc = <0>;

	qcom,rbatt-sf-lut {
		qcom,lut-col-legend = <(-20) 0 25 40 60>;
		qcom,lut-row-legend = <100 95 90 85 80>,
				<75 70 65 60 55>,
				<50 45 40 35 30>,
				<25 20 16 13 11>,
				<10 9 8 7 6>,
				<5 4 3 2 1>,
				<0>;
		qcom,lut-data = <1703 309 100 78 72>,
				<1697 309 100 78 72>,
				<1578 312 100 79 73>,
				<1495 315 102 80 73>,
				<1397 318 104 81 73>,
				<1369 315 108 82 75>,
				<1358 291 114 86 76>,
				<1365 290 123 91 79>,
				<1380 290 123 98 83>,
				<1403 296 107 92 81>,
				<1429 308 100 81 74>,
				<1460 327 102 80 74>,
				<1497 353 104 82 75>,
				<1548 385 106 85 78>,
				<1675 425 108 85 76>,
				<1995 474 111 83 75>,
				<2525 530 112 82 75>,
				<3136 588 115 84 75>,
				<3382 634 115 84 74>,
				<4139 703 119 84 74>,
				<4649 748 121 85 75>,
				<5286 801 126 86 76>,
				<6045 866 131 89 78>,
				<7037 939 138 91 79>,
				<8314 1023 146 93 79>,
				<9983 1122 154 92 77>,
				<12366 1266 159 94 78>,
				<15800 1586 176 99 80>,
				<21166 2160 213 110 87>,
				<37414 3440 293 134 108>,
				<101611 34697 46695 37703 16953>;
	};

	qcom,fcc-temp-lut {
		qcom,lut-col-legend = <(-20) 0 25 40 60>;
		qcom,lut-data = <2396 2409 2411 2409 2399>;
	};

	qcom,pc-temp-ocv-lut {
		qcom,lut-col-legend = <(-20) 0 25 40 60>;
		qcom,lut-row-legend = <100 95 90 85 80>,
				<75 70 65 60 55>,
				<50 45 40 35 30>,
				<25 20 16 13 11>,
				<10 9 8 7 6>,
				<5 4 3 2 1>,
				<0>;
		qcom,lut-data = <4314 4318 4316 4318 4313>,
				<4197 4237 4248 4250 4248>,
				<4119 4176 4191 4192 4190>,
				<4055 4123 4136 4137 4135>,
				<3977 4074 4085 4086 4084>,
				<3930 4017 4038 4038 4036>,
				<3891 3956 3993 3995 3993>,
				<3861 3917 3955 3956 3954>,
				<3838 3879 3913 3918 3917>,
				<3817 3848 3868 3875 3875>,
				<3799 3822 3836 3838 3838>,
				<3782 3802 3813 3814 3814>,
				<3766 3788 3795 3796 3795>,
				<3751 3777 3780 3781 3780>,
				<3736 3765 3770 3767 3762>,
				<3720 3749 3758 3750 3739>,
				<3701 3726 3739 3731 3718>,
				<3680 3704 3715 3709 3696>,
				<3660 3692 3691 3686 3674>,
				<3642 3684 3683 3678 3667>,
				<3630 3680 3681 3676 3666>,
				<3618 3676 3679 3675 3664>,
				<3602 3671 3676 3673 3663>,
				<3583 3663 3672 3670 3660>,
				<3561 3647 3664 3662 3652>,
				<3531 3620 3641 3639 3626>,
				<3491 3578 3596 3595 3580>,
				<3436 3520 3533 3533 3518>,
				<3348 3435 3450 3450 3434>,
				<3210 3303 3326 3324 3300>,
				<3000 3000 3000 3000 3000>;
	};
};
