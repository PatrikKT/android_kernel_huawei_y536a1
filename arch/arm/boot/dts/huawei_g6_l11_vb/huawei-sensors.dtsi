 / {
        huawei_sensor_info {
                  compatible = "huawei,hw_sensor_info";
                  status = "ok";
        };
        adsp_sensor_info {
                  compatible = "huawei,hw_adsp_info";
                  product_name = "G6";
        };
};
