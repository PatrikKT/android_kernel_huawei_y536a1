 / {
        huawei_fac_info {
                  compatible = "huawei,hw_fac_info";
                  fac,product_name = "HUAWEI G730-L072";
                  fac,hardware_ver = "HL1G730L072M";
		  fac,software_ver = "MSM8926_G730-L072_VA";
                  status = "ok";
        };
};
