/*---------------------------------------------------------------------------
 * This file is autogenerated file using huawei LCD parser. Please do not edit it.
 * Update input XML file to add a new entry or update variable in this file
 * Parser location: device/qcom/common/display/tools/huawei_lcd_panel 
 *---------------------------------------------------------------------------*/



/include/ "hw-panel-boe-nt35517-4p5-qhd-video.dtsi"
/include/ "hw-panel-boe-nt35517-5-qhd-video.dtsi"
/include/ "hw-panel-boe-nt35521-5-720p-video.dtsi"
/include/ "hw-panel-cmi-otm1283a-5-720p-video.dtsi"
/include/ "hw-panel-tianma-otm9605a-4p5-qhd-video.dtsi"
/include/ "hw-panel-tianma-otm9605a-5-qhd-video.dtsi"
/include/ "hw-panel-truly-hx8389b-4p5-qhd-video.dtsi"
/include/ "default_lcd.dtsi"

