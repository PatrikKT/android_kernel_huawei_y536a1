/* Copyright (c) 2012-2013, The Linux Foundation. All rights reserved.
 *
 * This program is free software; you can redistribute it and/or modify
 * it under the terms of the GNU General Public License version 2 and
 * only version 2 as published by the Free Software Foundation.
 *
 * This program is distributed in the hope that it will be useful,
 * but WITHOUT ANY WARRANTY; without even the implied warranty of
 * MERCHANTABILITY or FITNESS FOR A PARTICULAR PURPOSE.  See the
 * GNU General Public License for more details.
 */

/ {
	mipi_nt35521_720p_video_tianma {
		compatible = "huawei,lcd_panel_id2";
		label = "mipi_nt35521_720p_video_tianma";
		status = "disable";
		qcom,dsi-ctrl-phandle = <&mdss_dsi0>;
		qcom,bl-enable-gpio = <&msmgpio 22 0>;
		qcom,enable-gpio = <&msmgpio 23 0>;
		qcom,rst-gpio = <&msmgpio 25 0>;
		qcom,mdss-pan-res = <720 1280>;
		qcom,mdss-pan-bpp = <24>;
		qcom,mdss-pan-dest = "display_1";
		qcom,mdss-pan-porch-values = <70 5 54 15 3 10>;
		qcom,mdss-pan-underflow-clr = <0xff>;
		qcom,mdss-pan-bl-ctrl = "bl_ctrl_dcs";
		qcom,mdss-pan-bl-levels = <1 255>;
		qcom,mdss-pan-dsi-mode = <0>;
		qcom,mdss-pan-dsi-h-pulse-mode = <1>;
		qcom,mdss-pan-dsi-h-power-stop = <0 0 0>;
		qcom,mdss-pan-dsi-bllp-power-stop = <1 1>;
		qcom,mdss-pan-dsi-traffic-mode = <2>;
		qcom,mdss-pan-dsi-dst-format = <3>;
		qcom,mdss-pan-dsi-vc = <0>;
		qcom,mdss-pan-dsi-rgb-swap = <0>;
		qcom,mdss-pan-dsi-data-lanes = <1 1 1 1>; /* 4 lanes */
		qcom,mdss-pan-dsi-dlane-swap = <0>;
		qcom,mdss-pan-dsi-t-clk = <0x2d 0x20>;
		qcom,mdss-pan-dsi-stream = <0>;
		qcom,mdss-pan-dsi-mdp-tr = <0x0>;
		qcom,mdss-pan-dsi-dma-tr = <0x04>;
		qcom,mdss-pan-dsi-frame-rate = <60>;
		qcom,panel-phy-regulatorSettings = [07 09 03 00  /* Regualotor settings */
						    20 00 01];
		qcom,panel-phy-timingSettings = [61 1f 17 00 2f 2d
						    1c 21 29 03 04 00];
		qcom,panel-phy-strengthCtrl = [ff 06];
		qcom,panel-phy-bistCtrl = [00 00 b1 ff           /* BIST Ctrl settings */
					   00 00];
		qcom,panel-phy-laneConfig = [00 00 00 00 00 00 00 01 97 /* lane0 config */
					     00 00 00 00 05 00 00 01 97 /* lane1 config */
					     00 00 00 00 0a 00 00 01 97 /* lane2 config */
					     00 00 00 00 0f 00 00 01 97 /* lane3 config */
					     00 c0 00 00 00 00 00 01 bb]; /* Clk ln config */
		qcom,panel-on-cmds = [  29 01 00 00 00 00 05 FF AA 55 A5 80
					29 01 00 00 00 00 03 6F 11 00
					29 01 00 00 00 00 03 F7 20 00
					29 01 00 00 00 00 02 6F 11
					29 01 00 00 00 00 02 F3 01
					29 01 00 00 00 00 06 F0 55 AA 52 08 00
					29 01 00 00 00 00 06 BD 01 A0 0C 08 01
					29 01 00 00 00 00 02 6F 02
					29 01 00 00 00 00 02 B8 0C
					29 01 00 00 00 00 03 BB 11 11
					29 01 00 00 00 00 03 BC 00 00
					29 01 00 00 00 00 02 B6 01
					29 01 00 00 00 00 06 F0 55 AA 52 08 01
					29 01 00 00 00 00 03 B0 09 09
					29 01 00 00 00 00 03 B1 09 09
					29 01 00 00 00 00 03 BC 78 00
					29 01 00 00 00 00 03 BD 78 00
					29 01 00 00 00 00 02 CA 00
					29 01 00 00 00 00 02 C0 04
					29 01 00 00 00 00 03 B5 03 03
					29 01 00 00 00 00 02 BE 5B
					29 01 00 00 00 00 03 B3 28 28
					29 01 00 00 00 00 03 B4 0F 0F
					29 01 00 00 00 00 03 B9 34 34
					29 01 00 00 00 00 03 BA 15 15
					29 01 00 00 00 00 06 F0 55 AA 52 08 02
					29 01 00 00 00 00 02 EE 01
					29 01 00 00 00 00 11 B0 00 00 00 2A 00 7F 00 B2 00 CA 00 E6 01 05 01 3A
					29 01 00 00 00 00 11 B1 01 5D 01 96 01 C2 02 0A 02 45 02 46 02 7D 02 B4
					29 01 00 00 00 00 11 B2 02 D9 03 05 03 24 03 4E 03 65 03 A6 03 D1 03 EC
					29 01 00 00 00 00 05 B3 03 F8 03 FA
					29 01 00 00 00 00 02 6F 02
					29 01 00 00 00 00 02 F7 47
					29 01 00 00 00 00 02 6F 0A
					29 01 00 00 00 00 02 F7 02
					29 01 00 00 00 00 02 6F 17
					29 01 00 00 00 00 02 F4 70
					29 01 00 00 00 00 02 6F 11
					29 01 00 00 00 00 02 F3 01
					29 01 00 00 00 00 06 F0 55 AA 52 08 06
					29 01 00 00 00 00 03 B0 12 10
					29 01 00 00 00 00 03 B1 18 16
					29 01 00 00 00 00 03 B2 00 02
					29 01 00 00 00 00 03 B3 31 31
					29 01 00 00 00 00 03 B4 31 31
					29 01 00 00 00 00 03 B5 31 31
					29 01 00 00 00 00 03 B6 31 31
					29 01 00 00 00 00 03 B7 31 31
					29 01 00 00 00 00 03 B8 31 08
					29 01 00 00 00 00 03 B9 2E 2D
					29 01 00 00 00 00 03 BA 2D 2E
					29 01 00 00 00 00 03 BB 09 31
					29 01 00 00 00 00 03 BC 31 31
					29 01 00 00 00 00 03 BD 31 31
					29 01 00 00 00 00 03 BE 31 31
					29 01 00 00 00 00 03 BF 31 31
					29 01 00 00 00 00 03 C0 31 31
					29 01 00 00 00 00 03 C1 03 01
					29 01 00 00 00 00 03 C2 17 19
					29 01 00 00 00 00 03 C3 11 13
					29 01 00 00 00 00 03 E5 31 31
					29 01 00 00 00 00 03 C4 17 19
					29 01 00 00 00 00 03 C5 11 13
					29 01 00 00 00 00 03 C6 03 01
					29 01 00 00 00 00 03 C7 31 31
					29 01 00 00 00 00 03 C8 31 31
					29 01 00 00 00 00 03 C9 31 31
					29 01 00 00 00 00 03 CA 31 31
					29 01 00 00 00 00 03 CB 31 31
					29 01 00 00 00 00 03 CC 31 09
					29 01 00 00 00 00 03 CD 2D 2E
					29 01 00 00 00 00 03 CE 2E 2D
					29 01 00 00 00 00 03 CF 08 31
					29 01 00 00 00 00 03 D0 31 31
					29 01 00 00 00 00 03 D1 31 31
					29 01 00 00 00 00 03 D2 31 31
					29 01 00 00 00 00 03 D3 31 31
					29 01 00 00 00 00 03 D4 31 31
					29 01 00 00 00 00 03 D5 00 02
					29 01 00 00 00 00 03 D6 12 10
					29 01 00 00 00 00 03 D7 18 16
					29 01 00 00 00 00 06 D8 00 00 00 00 00
					29 01 00 00 00 00 06 D9 00 00 00 00 00
					29 01 00 00 00 00 02 E7 00
					29 01 00 00 00 00 06 F0 55 AA 52 08 05
					29 01 00 00 00 00 02 ED 30
					29 01 00 00 00 00 06 F0 55 AA 52 08 03
					29 01 00 00 00 00 03 B1 00 00
					29 01 00 00 00 00 03 B0 20 00
					29 01 00 00 00 00 06 F0 55 AA 52 08 05
					29 01 00 00 00 00 02 E5 00
					29 01 00 00 00 00 06 F0 55 AA 52 08 05
					29 01 00 00 00 00 03 B0 17 06
					29 01 00 00 00 00 02 B8 00
					29 01 00 00 00 00 06 BD 03 03 01 00 03
					29 01 00 00 00 00 03 B1 17 06
					29 01 00 00 00 00 03 B9 00 03
					29 01 00 00 00 00 03 B2 17 06
					29 01 00 00 00 00 03 BA 00 00
					29 01 00 00 00 00 03 B3 17 06
					29 01 00 00 00 00 03 BB 00 00
					29 01 00 00 00 00 03 B4 17 06
					29 01 00 00 00 00 03 B5 17 06
					29 01 00 00 00 00 03 B6 17 06
					29 01 00 00 00 00 03 B7 17 06
					29 01 00 00 00 00 03 BC 00 03
					29 01 00 00 00 00 02 E5 06
					29 01 00 00 00 00 02 E6 06
					29 01 00 00 00 00 02 E7 06
					05 01 00 00 00 00 02 E8 06
					29 01 00 00 00 00 02 E9 06
					29 01 00 00 00 00 02 EA 06
					29 01 00 00 00 00 02 EB 06
					29 01 00 00 00 00 02 EC 06
					29 01 00 00 00 00 06 F0 55 AA 52 08 05
					29 01 00 00 00 00 02 C0 0B
					29 01 00 00 00 00 02 C1 09
					29 01 00 00 00 00 02 C2 0B
					29 01 00 00 00 00 02 C3 09
					29 01 00 00 00 00 06 F0 55 AA 52 08 03
					29 01 00 00 00 00 06 B2 05 00 00 00 90
					29 01 00 00 00 00 06 B3 05 00 00 00 90
					29 01 00 00 00 00 06 B4 05 00 00 00 90
					29 01 00 00 00 00 06 B5 05 00 00 00 90
					29 01 00 00 00 00 06 F0 55 AA 52 08 05
					29 01 00 00 00 00 02 C4 10
					29 01 00 00 00 00 02 C5 10
					29 01 00 00 00 00 02 C6 10
					29 01 00 00 00 00 02 C7 10
					29 01 00 00 00 00 06 F0 55 AA 52 08 03
					29 01 00 00 00 00 06 B6 05 00 00 00 90
					29 01 00 00 00 00 06 B7 05 00 00 00 90
					29 01 00 00 00 00 06 B8 05 00 00 00 90
					29 01 00 00 00 00 06 B9 05 00 00 00 90
					29 01 00 00 00 00 06 F0 55 AA 52 08 05
					29 01 00 00 00 00 03 C8 07 20
					29 01 00 00 00 00 03 C9 03 20
					29 01 00 00 00 00 03 CA 07 00
					29 01 00 00 00 00 03 CB 03 00
					29 01 00 00 00 00 06 F0 55 AA 52 08 03
					29 01 00 00 00 00 06 BA 44 00 00 01 00
					29 01 00 00 00 00 06 BB 44 00 00 01 00
					29 01 00 00 00 00 06 BC 44 00 00 01 00
					29 01 00 00 00 00 06 BD 44 00 00 01 00
					29 01 00 00 00 00 06 F0 55 AA 52 08 05
					29 01 00 00 00 00 06 D1 00 05 00 07 10
					29 01 00 00 00 00 06 D2 00 05 04 07 10
					29 01 00 00 00 00 06 D3 00 00 0A 07 10
					29 01 00 00 00 00 06 D4 00 00 0A 07 10
					29 01 00 00 00 00 06 F0 55 AA 52 08 05
					29 01 00 00 00 00 08 D0 00 00 00 00 00 00 00
					29 01 00 00 00 00 0c D5 00 00 00 00 00 00 00 00 00 00 00
					29 01 00 00 00 00 0c D6 00 00 00 00 00 00 00 00 00 00 00
					29 01 00 00 00 00 0c D7 00 00 00 00 00 00 00 00 00 00 00
					29 01 00 00 00 00 06 D8 00 00 00 00 00
					29 01 00 00 00 00 06 F0 55 AA 52 08 03
					29 01 00 00 00 00 02 C4 60
					29 01 00 00 00 00 02 C5 40
					29 01 00 00 00 00 02 C6 60
					29 01 00 00 00 00 02 C7 40
					29 01 00 00 00 00 02 6F 01
					29 01 00 00 00 00 02 F9 46
					29 01 00 00 00 00 02 6F 12
					29 01 00 00 00 00 02 F3 80
					29 01 00 00 00 00 02 6F 0C
					29 01 00 00 00 00 05 F3 FF 0F FF FF
					29 01 00 00 00 00 02 6F 12
					29 01 00 00 00 00 02 F3 00
					29 01 00 00 00 00 06 F0 55 AA 52 08 01
					29 01 00 00 00 00 03 BC 78 00
					29 01 00 00 00 00 03 BD 78 00
					29 01 00 00 00 00 06 F0 55 AA 52 08 02  
					29 01 00 00 00 00 02 EE 01
					29 01 00 00 00 00 11 B0 00 00 00 2A 00 7F 00 B2 00 CA 00 E6 01 05 01 3A
					29 01 00 00 00 00 11 B1 01 5D 01 96 01 C2 02 0A 02 45 02 46 02 7D 02 B4
					29 01 00 00 00 00 11 B2 02 D9 03 05 03 24 03 4E 03 65 03 A6 03 D1 03 EC
					29 01 00 00 00 00 05 B3 03 F8 03 FA
					29 01 00 00 00 00 06 F0 55 AA 52 08 00
					29 01 00 00 00 00 03 D9 02 05
					29 01 00 00 00 00 02 55 01
					29 01 00 00 00 00 02 53 24
					29 01 00 00 00 00 02 51 00
					05 01 00 00 78 00 02 11 00
					05 01 00 00 16 00 02 29 00];

		qcom,on-cmds-dsi-state = "DSI_LP_MODE";
		qcom,panel-off-cmds = [ 05 01 00 00 16 00 02 28 00
					05 01 00 00 78 00 02 10 00];
		qcom,off-cmds-dsi-state = "DSI_HS_MODE";

		qcom,panel-cabc-ui-cmds = [13 01 00 00 00 00 02 55 01
					   13 01 00 00 00 00 02 53 24];
		qcom,cabc-ui-cmds-dsi-state = "DSI_LP_MODE";
		qcom,panel-cabc-video-cmds = [13 01 00 00 00 00 02 55 03
					      13 01 00 00 00 00 02 53 24];
		qcom,cabc-video-cmds-dsi-state = "DSI_LP_MODE";
		
		huawei,mdss-panel-read-flag = <0>;
		huawei,panel-read-register = [0A 00];
	};
};
