 &soc {
	qcom,spmi@fc4c0000 {
		qcom,pm8226@1 {
			qcom,vibrator@c000 {
				compatible = "huawei,qpnp-vibrator";
				huawei,vib-timeout-ms = <15000>;
				huawei,vib-vtg-level-mV = <2800>;
				reg = <0xc000 0x100>;
				label = "vibrator";
				status = "ok";
			};
		};
	};
};
