/* Copyright (c) 2012-2013, The Linux Foundation. All rights reserved.
 *
 * This program is free software; you can redistribute it and/or modify
 * it under the terms of the GNU General Public License version 2 and
 * only version 2 as published by the Free Software Foundation.
 *
 * This program is distributed in the hope that it will be useful,
 * but WITHOUT ANY WARRANTY; without even the implied warranty of
 * MERCHANTABILITY or FITNESS FOR A PARTICULAR PURPOSE.  See the
 * GNU General Public License for more details.
 */
/* modify b6 register to reduce the chance of crosstalk */
/* delete vcom setting and modify pwm frequency to 45.9kHz */
/* added CABC and dynamic gama feature*/
/* Add parameters to solve panle can't display when power on */

/ {
	mipi_nt35520_720p_cmd_tianma {
		compatible = "huawei,lcd_panel_id0";
		label = "mipi_nt35520_720p_cmd_tianma";
		status = "disable";
		qcom,dsi-ctrl-phandle = <&mdss_dsi0>;
		qcom,bl-enable-gpio = <&msmgpio 22 0>;
		qcom,enable-gpio = <&msmgpio 23 0>;
		qcom,te-gpio = <&msmgpio 24 0>;
		qcom,rst-gpio = <&msmgpio 25 0>;
		qcom,mdss-pan-res = <720 1280>;
		qcom,mdss-pan-bpp = <24>;
		qcom,mdss-pan-dest = "display_1";
		qcom,mdss-pan-porch-values = <164 8 140 1 1 6>;
		qcom,mdss-pan-underflow-clr = <0xff>;
		qcom,mdss-pan-bl-ctrl = "bl_ctrl_dcs";
		qcom,mdss-pan-bl-levels = <1 255>;
		qcom,mdss-pan-dsi-mode = <1>;
		qcom,mdss-vsync-enable = <1>;
		qcom,mdss-hw-vsync-mode = <1>;
		qcom,mdss-pan-dsi-h-pulse-mode = <1>;
		qcom,mdss-pan-dsi-h-power-stop = <0 0 0>;
		qcom,mdss-pan-dsi-bllp-power-stop = <1 1>;
		qcom,mdss-pan-dsi-traffic-mode = <2>;
		qcom,mdss-pan-dsi-dst-format = <8>;
		qcom,mdss-pan-insert-dcs-cmd = <1>;
		qcom,mdss-pan-wr-mem-continue = <0x3c>;
		qcom,mdss-pan-wr-mem-start = <0x2c>;
		qcom,mdss-pan-te-sel = <1>;
		qcom,mdss-pan-dsi-vc = <0>;
		qcom,mdss-pan-dsi-rgb-swap = <0>;
		qcom,mdss-pan-dsi-data-lanes = <1 1 1 1>; /* 4 lanes */
		qcom,mdss-pan-dsi-dlane-swap = <0>;
		qcom,mdss-pan-dsi-t-clk = <0x2c 0x20>;
		qcom,mdss-pan-dsi-stream = <0>;
		qcom,mdss-pan-dsi-mdp-tr = <0x0>;
		qcom,mdss-pan-dsi-dma-tr = <0x04>;
		qcom,mdss-pan-dsi-frame-rate = <60>;
		qcom,panel-phy-regulatorSettings = [07 09 03 00  /* Regualotor settings */
						    20 00 01];
		qcom,panel-phy-timingSettings = [7d 25 1d 00 37 33
						    22 27 1e 03 04 00];
		qcom,panel-phy-strengthCtrl = [ff 06];
		qcom,panel-phy-bistCtrl = [00 00 b1 ff           /* BIST Ctrl settings */
					   00 00];
		qcom,panel-phy-laneConfig = [00 00 00 00 00 00 00 01 97 /* lane0 config */
					     00 00 00 00 05 00 00 01 97 /* lane1 config */
					     00 00 00 00 0a 00 00 01 97 /* lane2 config */
					     00 00 00 00 0f 00 00 01 97 /* lane3 config */
					     00 c0 00 00 00 00 00 01 bb]; /* Clk ln config */
		qcom,panel-on-cmds = [  29 01 00 00 00 00 05 FF AA 55 A5 80
					29 01 00 00 00 00 02 6F 02
					29 01 00 00 00 00 02 F7 2D
					29 01 00 00 00 00 06 F0 55 AA 52 08 00
					29 01 00 00 00 00 05 B8 00 00 00 00
					29 01 00 00 00 00 03 BB 11 11
					29 01 00 00 00 00 03 BC 00 00
					29 01 00 00 00 00 02 B6 08
					29 01 00 00 00 00 03 B1 7A 21
					29 01 00 00 00 00 06 F0 55 AA 52 08 01
					29 01 00 00 00 00 03 B0 09 09
					29 01 00 00 00 00 03 B1 09 09
					29 01 00 00 00 00 03 BC 80 00
					29 01 00 00 00 00 03 BD 80 00
					29 01 00 00 00 00 02 CA 00
					29 01 00 00 00 00 02 C0 04
					29 01 00 00 00 00 03 B5 03 03
					29 01 00 00 00 00 03 B3 1B 1B
					29 01 00 00 00 00 03 B4 0F 0F
					29 01 00 00 00 00 03 B9 26 26
					29 01 00 00 00 00 03 BA 24 24
					29 01 00 00 00 00 06 F0 55 AA 52 08 02
					29 01 00 00 00 00 02 EE 01
					29 01 00 00 00 00 11 B0 00 00 00 9F 00 C1 00 E2 00 FB 01 1D 01 38 01 63
					29 01 00 00 00 00 11 B1 01 86 01 BD 01 E7 02 2B 02 62 02 63 02 97 02 CF
					29 01 00 00 00 00 11 B2 02 F1 03 1D 03 38 03 5A 03 6E 03 80 03 87 03 8E
					29 01 00 00 00 00 05 B3 03 90 03 FE
					29 01 00 00 00 00 06 F0 55 AA 52 08 06
					29 01 00 00 00 00 03 B0 18 16
					29 01 00 00 00 00 03 B1 12 10
					29 01 00 00 00 00 03 B2 00 02
					29 01 00 00 00 00 03 B3 31 31
					29 01 00 00 00 00 03 B4 31 34
					29 01 00 00 00 00 03 B5 34 31
					29 01 00 00 00 00 03 B6 31 33
					29 01 00 00 00 00 03 B7 33 33
					29 01 00 00 00 00 03 B8 31 08
					29 01 00 00 00 00 03 B9 2E 2D
					29 01 00 00 00 00 03 BA 2D 2E
					29 01 00 00 00 00 03 BB 09 31
					29 01 00 00 00 00 03 BC 33 33
					29 01 00 00 00 00 03 BD 33 31
					29 01 00 00 00 00 03 BE 31 34
					29 01 00 00 00 00 03 BF 34 31
					29 01 00 00 00 00 03 C0 31 31
					29 01 00 00 00 00 03 C1 03 01
					29 01 00 00 00 00 03 C2 11 13
					29 01 00 00 00 00 03 C3 17 19
					29 01 00 00 00 00 03 E5 31 31
					29 01 00 00 00 00 03 C4 11 13
					29 01 00 00 00 00 03 C5 17 19
					29 01 00 00 00 00 03 C6 03 01
					29 01 00 00 00 00 03 C7 31 31
					29 01 00 00 00 00 03 C8 31 34
					29 01 00 00 00 00 03 C9 34 31
					29 01 00 00 00 00 03 CA 31 33
					29 01 00 00 00 00 03 CB 33 33
					29 01 00 00 00 00 03 CC 31 09
					29 01 00 00 00 00 03 CD 2D 2E
					29 01 00 00 00 00 03 CE 2E 2D
					29 01 00 00 00 00 03 CF 08 31
					29 01 00 00 00 00 03 D0 33 33
					29 01 00 00 00 00 03 D1 33 31
					29 01 00 00 00 00 03 D2 31 34
					29 01 00 00 00 00 03 D3 34 31
					29 01 00 00 00 00 03 D4 31 31
					29 01 00 00 00 00 03 D5 00 02
					29 01 00 00 00 00 03 D6 18 16
					29 01 00 00 00 00 03 D7 12 10
					29 01 00 00 00 00 06 D8 00 00 00 00 00
					29 01 00 00 00 00 06 D9 00 00 00 00 00
					29 01 00 00 00 00 02 E7 00
					29 01 00 00 00 00 06 F0 55 AA 52 08 05
					29 01 00 00 00 00 02 ED 30
					29 01 00 00 00 00 06 F0 55 AA 52 08 03
					29 01 00 00 00 00 03 B1 00 00
					29 01 00 00 00 00 03 B0 00 00
					29 01 00 00 00 00 06 F0 55 AA 52 08 05
					29 01 00 00 00 00 02 E5 00
					29 01 00 00 00 00 06 F0 55 AA 52 08 05
					29 01 00 00 00 00 03 B0 17 06
					29 01 00 00 00 00 02 B8 00
					29 01 00 00 00 00 06 BD 03 03 01 00 03
					29 01 00 00 00 00 03 B1 17 06
					29 01 00 00 00 00 03 B9 00 03
					29 01 00 00 00 00 03 B2 17 06
					29 01 00 00 00 00 03 BA 00 00
					29 01 00 00 00 00 03 B3 17 06
					29 01 00 00 00 00 03 BB 00 00
					29 01 00 00 00 00 03 B4 17 06
					29 01 00 00 00 00 03 B5 17 06
					29 01 00 00 00 00 03 B6 17 06
					29 01 00 00 00 00 03 B7 17 06
					29 01 00 00 00 00 03 BC 00 03
					29 01 00 00 00 00 02 E5 06
					29 01 00 00 00 00 02 E6 06
					29 01 00 00 00 00 02 E7 06
					29 01 00 00 00 00 02 E8 06
					29 01 00 00 00 00 02 E9 06
					29 01 00 00 00 00 02 EA 06
					29 01 00 00 00 00 02 EB 06
					29 01 00 00 00 00 02 EC 06
					29 01 00 00 00 00 06 F0 55 AA 52 08 05
					29 01 00 00 00 00 02 C0 0F
					29 01 00 00 00 00 02 C1 0D
					29 01 00 00 00 00 02 C2 0F
					29 01 00 00 00 00 02 C3 0D
					29 01 00 00 00 00 06 F0 55 AA 52 08 03
					29 01 00 00 00 00 06 B2 05 00 00 00 00
					29 01 00 00 00 00 06 B3 05 00 00 00 00
					29 01 00 00 00 00 06 B4 05 00 00 00 00
					29 01 00 00 00 00 06 B5 05 00 00 00 00
					29 01 00 00 00 00 06 F0 55 AA 52 08 05
					29 01 00 00 00 00 02 C4 14
					29 01 00 00 00 00 02 C5 14
					29 01 00 00 00 00 02 C6 14
					29 01 00 00 00 00 02 C7 14
					29 01 00 00 00 00 06 F0 55 AA 52 08 03
					29 01 00 00 00 00 06 B6 05 00 00 00 00
					29 01 00 00 00 00 06 B7 05 00 00 00 00
					29 01 00 00 00 00 06 B8 05 00 00 00 00
					29 01 00 00 00 00 06 B9 05 00 00 00 00
					29 01 00 00 00 00 06 F0 55 AA 52 08 05
					29 01 00 00 00 00 03 C8 0B 20
					29 01 00 00 00 00 03 C9 07 20
					29 01 00 00 00 00 03 CA 0B 00
					29 01 00 00 00 00 03 CB 07 00
					29 01 00 00 00 00 06 F0 55 AA 52 08 03
					29 01 00 00 00 00 06 BA 53 00 00 00 00
					29 01 00 00 00 00 06 BB 53 00 00 00 00
					29 01 00 00 00 00 06 BC 53 00 00 00 00
					29 01 00 00 00 00 06 BD 53 00 00 00 00
					29 01 00 00 00 00 06 F0 55 AA 52 08 05
					29 01 00 00 00 00 06 D1 00 05 04 07 10
					29 01 00 00 00 00 06 D2 00 05 08 07 10
					29 01 00 00 00 00 06 D3 00 00 0A 07 10
					29 01 00 00 00 00 06 D4 00 00 0A 07 10
					29 01 00 00 00 00 06 F0 55 AA 52 08 05
					29 01 00 00 00 00 08 D0 00 00 00 00 00 00 00
					29 01 00 00 00 00 0C D5 00 00 00 00 00 00 00 00 00 00 00
					29 01 00 00 00 00 0C D6 00 00 00 00 00 00 00 00 00 00 00
					29 01 00 00 00 00 0C D7 00 00 00 00 00 00 00 00 00 00 00
					29 01 00 00 00 00 06 D8 00 00 00 00 00
					29 01 00 00 00 00 06 F0 55 AA 52 08 03
					29 01 00 00 00 00 02 C4 60
					29 01 00 00 00 00 02 C5 40
					29 01 00 00 00 00 02 C6 60
					29 01 00 00 00 00 02 C7 40
					29 01 00 00 00 00 06 F0 55 AA 52 08 00
					23 01 00 00 00 00 03 D9 02 03
					13 01 00 00 00 00 02 D4 6B
					29 01 00 00 00 00 02 55 01
					29 01 00 00 00 00 02 53 24 
					29 01 00 00 00 00 02 35 00
					05 01 00 00 78 00 02 11 00
					05 01 00 00 16 00 02 29 00];

		qcom,on-cmds-dsi-state = "DSI_LP_MODE";
		qcom,panel-off-cmds = [05 01 00 00 16 00 02 28 00
					05 01 00 00 78 00 02 10 00];
		qcom,off-cmds-dsi-state = "DSI_HS_MODE";

		qcom,panel-cabc-ui-cmds = [13 01 00 00 00 00 02 55 01];
		qcom,cabc-ui-cmds-dsi-state = "DSI_LP_MODE";
		qcom,panel-cabc-video-cmds = [13 01 00 00 00 00 02 55 03];
		qcom,cabc-video-cmds-dsi-state = "DSI_LP_MODE";

		/*
		qcom,panel-gamma-22-cmds = [13 01 00 00 00 00 02 55 01];
		qcom,gamma-22-cmds-dsi-state = "DSI_LP_MODE";
		qcom,panel-gamma-25-cmds = [13 01 00 00 00 00 02 55 03];
		qcom,gamma_25-cmds-dsi-state = "DSI_LP_MODE";
		*/
		huawei,mdss-panel-read-flag = <1>;
		huawei,panel-read-register = [0A 00];
	};
};
