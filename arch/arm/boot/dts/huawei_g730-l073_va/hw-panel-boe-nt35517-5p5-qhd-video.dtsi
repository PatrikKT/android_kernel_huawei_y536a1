/* Copyright (c) 2013, The Linux Foundation. All rights reserved.
 *
 * This program is free software; you can redistribute it and/or modify
 * it under the terms of the GNU General Public License version 2 and
 * only version 2 as published by the Free Software Foundation.
 *
 * This program is distributed in the hope that it will be useful,
 * but WITHOUT ANY WARRANTY; without even the implied warranty of
 * MERCHANTABILITY or FITNESS FOR A PARTICULAR PURPOSE.  See the
 * GNU General Public License for more details.
 */

/*---------------------------------------------------------------------------
 * This file is autogenerated file using gcdb parser. Please do not edit it.
 * Update input XML file to add a new entry or update variable in this file
 * VERSION = "1.0"
 *---------------------------------------------------------------------------*/
&mdss_mdp {
	dsi_boe_nt35517_5p5_qhd_video: qcom,mdss_dsi_boe_nt35517_5p5_qhd_video {
		qcom,mdss-dsi-panel-name = "BOE_NT35517_5P5_QHD_VIDEO";
		qcom,cont-splash-enabled;
		qcom,mdss-dsi-panel-controller = <&mdss_dsi0>;
		qcom,mdss-dsi-panel-type = "dsi_video_mode";
		qcom,mdss-dsi-panel-destination = "display_1";
		qcom,mdss-dsi-panel-clockrate = <432000000>;
		qcom,mdss-dsi-panel-framerate = <60>;
		qcom,mdss-dsi-virtual-channel-id = <0>;
		qcom,mdss-dsi-stream = <0>;
		qcom,mdss-dsi-panel-width = <540>;
		qcom,mdss-dsi-panel-height = <960>;
		qcom,mdss-dsi-h-front-porch = <32>;
		qcom,mdss-dsi-h-back-porch = <32>;
		qcom,mdss-dsi-h-pulse-width = <4>;
		qcom,mdss-dsi-h-sync-skew = <0>;
		qcom,mdss-dsi-v-back-porch = <14>;
		qcom,mdss-dsi-v-front-porch = <12>;
		qcom,mdss-dsi-v-pulse-width = <2>;
		qcom,mdss-dsi-h-left-border = <0>;
		qcom,mdss-dsi-h-right-border = <0>;
		qcom,mdss-dsi-v-top-border = <0>;
		qcom,mdss-dsi-v-bottom-border = <0>;
		qcom,mdss-dsi-bpp = <24>;
		qcom,mdss-dsi-underflow-color = <0xff>;
		qcom,mdss-dsi-border-color = <0>;
		qcom,mdss-dsi-color-order = "rgb_swap_rgb";
		qcom,mdss-dsi-pixel-packing = "tight";
		qcom,mdss-dsi-on-command = [39 01 00 00 00 00 06 F0 55 AA 52 08 00
			39 01 00 00 00 00 06 B0 00 0C 40 3C 3C
			39 01 00 00 00 00 04 B1 60 00 00
			39 01 00 00 00 00 02 B3 00
			39 01 00 00 00 00 02 B6 08
			39 01 00 00 00 00 03 B7 00 00
			39 01 00 00 00 00 02 BA 01
			39 01 00 00 00 00 02 BC 00
			39 01 00 00 00 00 04 CC 03 00 00
			39 01 00 00 00 00 03 E0 01 01
			39 01 00 00 00 00 0B E3 E5 E3 E1 E0 DC D7 D0 CC C8 C4
			39 01 00 00 00 00 0A D4 01 00 00 00 00 00 00 00 00
			39 01 00 00 00 00 11 D6 01 05 09 0D 10 14 18 1C 20 24 28 2C 30 34 38 3C
			39 01 00 00 00 00 0D D7 28 2A 30 34 38 3D 00 00 00 00 00 00
			39 01 00 00 00 00 0E D8 05 05 00 00 00 00 05 05 00 00 00 00 00
			39 01 00 00 00 00 06 F0 55 AA 52 08 01
			39 01 00 00 00 00 04 B0 0A 0A 0A
			39 01 00 00 00 00 04 B6 43 43 43
			39 01 00 00 00 00 04 B1 0A 0A 0A
			39 01 00 00 00 00 04 B7 22 22 22
			39 01 00 00 00 00 04 B2 03 03 03
			39 01 00 00 00 00 04 B8 33 33 33
			39 01 00 00 00 00 04 B3 0A 0A 0A
			39 01 00 00 00 00 04 B9 24 24 24
			39 01 00 00 00 00 04 B4 0A 0A 0A
			39 01 00 00 00 00 04 BA 24 24 24
			39 01 00 00 00 00 04 B5 07 07 07
			39 01 00 00 00 00 04 BC 00 70 00
			39 01 00 00 00 00 04 BD 00 70 00
			39 01 00 00 00 00 11 D1 00 2D 00 3C 00 56 00 6C 00 7C 00 9B 00 BA 00 E9
			39 01 00 00 00 00 11 D2 01 0F 01 4A 01 79 01 C1 01 FF 02 00 02 37 02 72
			39 01 00 00 00 00 11 D3 02 99 02 CE 02 F6 03 2A 03 4C 03 79 03 97 03 BD
			39 01 00 00 00 00 05 D4 03 F5 03 FF
			39 01 00 00 00 00 11 D5 00 2D 00 3C 00 56 00 6C 00 7C 00 9B 00 BA 00 E9
			39 01 00 00 00 00 11 D6 01 0F 01 4A 01 79 01 C1 01 FF 02 00 02 37 02 72
			39 01 00 00 00 00 11 D7 02 99 02 CE 02 F6 03 2A 03 4C 03 79 03 97 03 BD
			39 01 00 00 00 00 05 D8 03 F5 03 FF
			39 01 00 00 00 00 11 D9 00 2D 00 3C 00 56 00 6C 00 7C 00 9B 00 BA 00 E9
			39 01 00 00 00 00 11 DD 01 0F 01 4A 01 79 01 C1 01 FF 02 00 02 37 02 72
			39 01 00 00 00 00 11 DE 02 99 02 CE 02 F6 03 2A 03 4C 03 79 03 97 03 BD
			39 01 00 00 00 00 05 DF 03 F5 03 FF
			39 01 00 00 00 00 11 E0 00 2D 00 3C 00 56 00 6C 00 7C 00 9B 00 BA 00 E9
			39 01 00 00 00 00 11 E1 01 0F 01 4A 01 79 01 C1 01 FF 02 00 02 37 02 72
			39 01 00 00 00 00 11 E2 02 99 02 CE 02 F6 03 2A 03 4C 03 79 03 97 03 BD
			39 01 00 00 00 00 05 E3 03 F5 03 FF
			39 01 00 00 00 00 11 E4 00 2D 00 3C 00 56 00 6C 00 7C 00 9B 00 BA 00 E9
			39 01 00 00 00 00 11 E5 01 0F 01 4A 01 79 01 C1 01 FF 02 00 02 37 02 72
			39 01 00 00 00 00 11 E6 02 99 02 CE 02 F6 03 2A 03 4C 03 79 03 97 03 BD
			39 01 00 00 00 00 05 E7 03 F5 03 FF
			39 01 00 00 00 00 11 E8 00 2D 00 3C 00 56 00 6C 00 7C 00 9B 00 BA 00 E9
			39 01 00 00 00 00 11 E9 01 0F 01 4A 01 79 01 C1 01 FF 02 00 02 37 02 72
			39 01 00 00 00 00 11 EA 02 99 02 CE 02 F6 03 2A 03 4C 03 79 03 97 03 BD
			39 01 00 00 00 00 05 EB 03 F5 03 FF
			39 01 00 00 00 00 06 F0 55 AA 52 00 00
			15 01 00 00 00 00 02 51 00
			15 01 00 00 00 00 02 53 24
			15 01 00 00 00 00 02 55 82
			15 01 00 00 00 00 02 5E 28
			05 01 00 00 78 00 02 11 00
			05 01 00 00 14 00 02 29 00];
		qcom,mdss-dsi-off-command = [05 01 00 00 14 00 02 28 00
					05 01 00 00 78 00 02 10 00];
		qcom,mdss-dsi-on-command-state = "dsi_lp_mode";
		qcom,mdss-dsi-off-command-state = "dsi_hs_mode";
		qcom,mdss-dsi-h-sync-pulse = <1>;
		qcom,mdss-dsi-traffic-mode = "burst_mode";
		qcom,mdss-dsi-lane-map = "lane_map_3012";
		qcom,mdss-dsi-bllp-eof-power-mode;
		qcom,mdss-dsi-bllp-power-mode;
		qcom,mdss-dsi-lane-0-state;
		qcom,mdss-dsi-lane-1-state;
		qcom,mdss-dsi-panel-timings = [7b 1a 10 00 3e 40 16 1e 15 03 04 00];
		qcom,mdss-dsi-reset-sequence = <1 1>, <0 20>, <1 120>;
		qcom,mdss-dsi-t-clk-post = <0x04>;
		qcom,mdss-dsi-t-clk-pre = <0x1b>;
		qcom,mdss-dsi-bl-min-level = <8>;
		qcom,mdss-dsi-bl-max-level = <255>;
		qcom,mdss-dsi-dma-trigger = "trigger_sw";
		qcom,mdss-dsi-mdp-trigger = "none";
		qcom,mdss-dsi-bl-pmic-control-type = "bl_ctrl_dcs";
		qcom,panel-inverse-off-cmds = [05 01 00 00 00 00 02 20 00];
		qcom,panel-inverse-on-cmds = [05 01 00 00 00 00 02 21 00];
		qcom,inverse-on-cmds-dsi-state = "dsi_lp_mode";
		qcom,inverse-off-cmds-dsi-state = "dsi_lp_mode";
		qcom,panel-cabc-ui-cmds = [29 01 00 00 00 00 06 F0 55 AA 52 08 00
					29 01 00 00 00 00 0B E3 E5 E3 E1 E0 DC D7 D0 CC C8 C4
					15 01 00 00 00 00 02 53 24];
		qcom,panel-cabc-video-cmds = [29 01 00 00 00 00 06 F0 55 AA 52 08 00
					29 01 00 00 00 00 0B E3 F0 D2 C3 B4 A5 96 87 87 87 81
					15 01 00 00 00 00 02 53 2C];
		qcom,cabc-ui-cmds-dsi-state = "dsi_hs_mode";
		qcom,cabc-video-cmds-dsi-state = "dsi_hs_mode";
		qcom,panel-dot-inversion-mode-cmds = [29 01 00 00 00 00 06 F0 55 AA 52 08 00
				29 01 00 00 00 00 02 BC 01];
		qcom,panel-column-inversion-mode-cmds = [29 01 00 00 00 00 06 F0 55 AA 52 08 00
				29 01 00 00 00 00 02 BC 00];
		qcom,dot-inversion-cmds-dsi-state = "dsi_lp_mode";
		qcom,column-inversion-cmds-dsi-state = "dsi_lp_mode";
		qcom,mdss-dsi-lp11-init;
	};
};
